
/*
 * DO NOT EDIT!
 * This file is generated by tools/Constant.PL.
 * Any changes to it will be lost the next time it is regenerated.
 */


/*
 * pbl_badPasteboardFlavorErr returns the value of badPasteboardFlavorErr.
 */

long pbl_badPasteboardFlavorErr ();

/*
 * pbl_badPasteboardIndexErr returns the value of badPasteboardIndexErr.
 */

long pbl_badPasteboardIndexErr ();

/*
 * pbl_badPasteboardItemErr returns the value of badPasteboardItemErr.
 */

long pbl_badPasteboardItemErr ();

/*
 * pbl_badPasteboardSyncErr returns the value of badPasteboardSyncErr.
 */

long pbl_badPasteboardSyncErr ();

/*
 * pbl_coreFoundationUnknownErr returns the value of coreFoundationUnknownErr.
 */

long pbl_coreFoundationUnknownErr ();

/*
 * pbl_duplicatePasteboardFlavorErr returns the value of duplicatePasteboardFlavorErr.
 */

long pbl_duplicatePasteboardFlavorErr ();

/*
 * pbl_kPasteboardClientIsOwner returns the value of kPasteboardClientIsOwner.
 */

unsigned long pbl_kPasteboardClientIsOwner ();

/*
 * pbl_kPasteboardClipboard returns the value of kPasteboardClipboard.
 * You must NOT free this reference after use.
 */

char * pbl_kPasteboardClipboard ();

/*
 * pbl_kPasteboardFind returns the value of kPasteboardFind.
 * You must NOT free this reference after use.
 */

char * pbl_kPasteboardFind ();

/*
 * pbl_kPasteboardFlavorNoFlags returns the value of kPasteboardFlavorNoFlags.
 */

unsigned long pbl_kPasteboardFlavorNoFlags ();

/*
 * pbl_kPasteboardFlavorNotSaved returns the value of kPasteboardFlavorNotSaved.
 */

unsigned long pbl_kPasteboardFlavorNotSaved ();

/*
 * pbl_kPasteboardFlavorPromised returns the value of kPasteboardFlavorPromised.
 */

unsigned long pbl_kPasteboardFlavorPromised ();

/*
 * pbl_kPasteboardFlavorRequestOnly returns the value of kPasteboardFlavorRequestOnly.
 */

unsigned long pbl_kPasteboardFlavorRequestOnly ();

/*
 * pbl_kPasteboardFlavorSenderOnly returns the value of kPasteboardFlavorSenderOnly.
 */

unsigned long pbl_kPasteboardFlavorSenderOnly ();

/*
 * pbl_kPasteboardFlavorSenderTranslated returns the value of kPasteboardFlavorSenderTranslated.
 */

unsigned long pbl_kPasteboardFlavorSenderTranslated ();

/*
 * pbl_kPasteboardFlavorSystemTranslated returns the value of kPasteboardFlavorSystemTranslated.
 */

unsigned long pbl_kPasteboardFlavorSystemTranslated ();

/*
 * pbl_kPasteboardModified returns the value of kPasteboardModified.
 */

unsigned long pbl_kPasteboardModified ();

/*
 * pbl_kPasteboardUniqueName returns the value of kPasteboardUniqueName.
 * You must NOT free this reference after use.
 */

char * pbl_kPasteboardUniqueName ();

/*
 * pbl_noPasteboardPromiseKeeperErr returns the value of noPasteboardPromiseKeeperErr.
 */

long pbl_noPasteboardPromiseKeeperErr ();

/*
 * pbl_notPasteboardOwnerErr returns the value of notPasteboardOwnerErr.
 */

long pbl_notPasteboardOwnerErr ();
