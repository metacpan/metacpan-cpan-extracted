void*
cs_VAdd3(vint1, vint2, vint3)
    void* vint1
    void* vint2
    void* vint3
CODE:
    RETVAL = cs_VAdd(3, vint1, vint2, vint3);
OUTPUT:
    RETVAL

void*
cs_VAdd4(vint1, vint2, vint3, vint4)
    void* vint1
    void* vint2
    void* vint3
    void* vint4
CODE:
    RETVAL = cs_VAdd(4, vint1, vint2, vint3, vint4);
OUTPUT:
    RETVAL

void*
cs_VAdd5(vint1, vint2, vint3, vint4, vint5)
    void* vint1
    void* vint2
    void* vint3
    void* vint4
    void* vint5
CODE:
    RETVAL = cs_VAdd(5, vint1, vint2, vint3, vint4, vint5);
OUTPUT:
    RETVAL

void*
cs_VAdd6(vint1, vint2, vint3, vint4, vint5, vint6)
    void* vint1
    void* vint2
    void* vint3
    void* vint4
    void* vint5
    void* vint6
CODE:
    RETVAL = cs_VAdd(6, vint1, vint2, vint3, vint4, vint5, vint6);
OUTPUT:
    RETVAL

void*
cs_VAdd7(vint1, vint2, vint3, vint4, vint5, vint6, vint7)
    void* vint1
    void* vint2
    void* vint3
    void* vint4
    void* vint5
    void* vint6
    void* vint7
CODE:
    RETVAL = cs_VAdd(7, vint1, vint2, vint3, vint4, vint5, vint6, vint7);
OUTPUT:
    RETVAL

void*
cs_VAdd8(vint1, vint2, vint3, vint4, vint5, vint6, vint7, vint8)
    void* vint1
    void* vint2
    void* vint3
    void* vint4
    void* vint5
    void* vint6
    void* vint7
    void* vint8
CODE:
    RETVAL = cs_VAdd(8, vint1, vint2, vint3, vint4, vint5, vint6, vint7, vint8);
OUTPUT:
    RETVAL

void*
cs_VAdd9(vint1, vint2, vint3, vint4, vint5, vint6, vint7, vint8, vint9)
    void* vint1
    void* vint2
    void* vint3
    void* vint4
    void* vint5
    void* vint6
    void* vint7
    void* vint8
    void* vint9
CODE:
    RETVAL = cs_VAdd(9, vint1, vint2, vint3, vint4, vint5, vint6, vint7, vint8, vint9);
OUTPUT:
    RETVAL

void*
cs_VAdd10(vint1, vint2, vint3, vint4, vint5, vint6, vint7, vint8, vint9, vint10)
    void* vint1
    void* vint2
    void* vint3
    void* vint4
    void* vint5
    void* vint6
    void* vint7
    void* vint8
    void* vint9
    void* vint10
CODE:
    RETVAL = cs_VAdd(10, vint1, vint2, vint3, vint4, vint5, vint6, vint7, vint8, vint9, vint10);
OUTPUT:
    RETVAL

