<lines>
  <line id="S1"      name="S1"      color="#DD6CA6" />
  <line id="S2"      name="S2"      color="#007B3D" />
  <line id="S3"      name="S3"      color="#0065AE" />
  <line id="S5"      name="S5"      color="#EE7202" />
  <line id="S7"      name="S7"      color="#846DAB" />
  <line id="S8"      name="S8"      color="#62AD2D" />
  <line id="S9"      name="S9"      color="#9B2B48" />
  <line id="S25"     name="S25"     color="#03D169" />
  <line id="S41/S42" name="S41/S42" color="#AF5937" />
  <line id="S45"     name="S45"     color="#CD9C53" />
  <line id="S46"     name="S46"     color="#E0BE8E" />
  <line id="S47"     name="S47"     color="#E9A037" />
  <line id="S75"     name="S75"     color="#AFA0C8" />
  <line id="S85"     name="S85"     color="#A8DB7F" />
  <line id="U1"      name="U1"      color="#60CE06" />
  <line id="U2"      name="U2"      color="#E94E0E" />
  <line id="U3"      name="U3"      color="#00A192" />
  <line id="U4"      name="U4"      color="#FFD500" />
  <line id="U5"      name="U5"      color="#815237" />
  <line id="U6"      name="U6"      color="#846DAB" />
  <line id="U7"      name="U7"      color="#009BD9" />
  <line id="U8"      name="U8"      color="#00599A" />
  <line id="U9"      name="U9"      color="#F28700" />
  <line id="U55"     name="U55"     color="#C39275" />
</lines>
