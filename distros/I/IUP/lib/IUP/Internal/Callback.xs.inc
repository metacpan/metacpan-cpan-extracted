# BEWARE: this is a generated file, DO NOT EDIT THIS FILE MANUALLY!!!

MODULE = IUP::Internal::Callback	PACKAGE = IUP::Internal::Callback

void
_clear_cb(ih,action)
		Ihandle* ih;
		char* action;
	CODE:
		IupSetCallback(ih, action, NULL);


void
_init_cb_ACTION_(ih)
		Ihandle* ih;
	CODE:
		IupSetCallback(ih, "ACTION", (Icallback)internal_cb_ACTION_);

void
_init_cb_BUTTON_CB_iiiis(ih)
		Ihandle* ih;
	CODE:
		IupSetCallback(ih, "BUTTON_CB", (Icallback)internal_cb_BUTTON_CB_iiiis);

void
_init_cb_VALUECHANGED_CB_(ih)
		Ihandle* ih;
	CODE:
		IupSetCallback(ih, "VALUECHANGED_CB", (Icallback)internal_cb_VALUECHANGED_CB_);

void
_init_cb_SWAPBUFFERS_CB_(ih)
		Ihandle* ih;
	CODE:
		IupSetCallback(ih, "SWAPBUFFERS_CB", (Icallback)internal_cb_SWAPBUFFERS_CB_);

void
_init_cb_DRAW_CB_iiiiiiv(ih)
		Ihandle* ih;
	CODE:
		IupSetCallback(ih, "DRAW_CB", (Icallback)internal_cb_DRAW_CB_iiiiiiv);

void
_init_cb_HEIGHT_CB_i(ih)
		Ihandle* ih;
	CODE:
		IupSetCallback(ih, "HEIGHT_CB", (Icallback)internal_cb_HEIGHT_CB_i);

void
_init_cb_HSPAN_CB_ii(ih)
		Ihandle* ih;
	CODE:
		IupSetCallback(ih, "HSPAN_CB", (Icallback)internal_cb_HSPAN_CB_ii);

void
_init_cb_MOUSECLICK_CB_iiiiiis(ih)
		Ihandle* ih;
	CODE:
		IupSetCallback(ih, "MOUSECLICK_CB", (Icallback)internal_cb_MOUSECLICK_CB_iiiiiis);

void
_init_cb_MOUSEMOTION_CB_iiiis(ih)
		Ihandle* ih;
	CODE:
		IupSetCallback(ih, "MOUSEMOTION_CB", (Icallback)internal_cb_MOUSEMOTION_CB_iiiis);

void
_init_cb_NCOLS_CB_(ih)
		Ihandle* ih;
	CODE:
		IupSetCallback(ih, "NCOLS_CB", (Icallback)internal_cb_NCOLS_CB_);

void
_init_cb_NLINES_CB_(ih)
		Ihandle* ih;
	CODE:
		IupSetCallback(ih, "NLINES_CB", (Icallback)internal_cb_NLINES_CB_);

void
_init_cb_SCROLLING_CB_ii(ih)
		Ihandle* ih;
	CODE:
		IupSetCallback(ih, "SCROLLING_CB", (Icallback)internal_cb_SCROLLING_CB_ii);

void
_init_cb_VSPAN_CB_ii(ih)
		Ihandle* ih;
	CODE:
		IupSetCallback(ih, "VSPAN_CB", (Icallback)internal_cb_VSPAN_CB_ii);

void
_init_cb_WIDTH_CB_i(ih)
		Ihandle* ih;
	CODE:
		IupSetCallback(ih, "WIDTH_CB", (Icallback)internal_cb_WIDTH_CB_i);

void
_init_cb_CELL_CB_i(ih)
		Ihandle* ih;
	CODE:
		IupSetCallback(ih, "CELL_CB", (Icallback)internal_cb_CELL_CB_i);

void
_init_cb_EXTENDED_CB_i(ih)
		Ihandle* ih;
	CODE:
		IupSetCallback(ih, "EXTENDED_CB", (Icallback)internal_cb_EXTENDED_CB_i);

void
_init_cb_SELECT_CB_ii(ih)
		Ihandle* ih;
	CODE:
		IupSetCallback(ih, "SELECT_CB", (Icallback)internal_cb_SELECT_CB_ii);

void
_init_cb_SWITCH_CB_ii(ih)
		Ihandle* ih;
	CODE:
		IupSetCallback(ih, "SWITCH_CB", (Icallback)internal_cb_SWITCH_CB_ii);

void
_init_cb_CHANGE_CB_ccc(ih)
		Ihandle* ih;
	CODE:
		IupSetCallback(ih, "CHANGE_CB", (Icallback)internal_cb_CHANGE_CB_ccc);

void
_init_cb_DRAG_CB_ccc(ih)
		Ihandle* ih;
	CODE:
		IupSetCallback(ih, "DRAG_CB", (Icallback)internal_cb_DRAG_CB_ccc);

void
_init_cb_COLORUPDATE_CB_(ih)
		Ihandle* ih;
	CODE:
		IupSetCallback(ih, "COLORUPDATE_CB", (Icallback)internal_cb_COLORUPDATE_CB_);

void
_init_cb_DETACHED_CB_(ih)
		Ihandle* ih;
	CODE:
		IupSetCallback(ih, "DETACHED_CB", (Icallback)internal_cb_DETACHED_CB_);

void
_init_cb_BUTTON_PRESS_CB_d(ih)
		Ihandle* ih;
	CODE:
		IupSetCallback(ih, "BUTTON_PRESS_CB", (Icallback)internal_cb_BUTTON_PRESS_CB_d);

void
_init_cb_BUTTON_RELEASE_CB_d(ih)
		Ihandle* ih;
	CODE:
		IupSetCallback(ih, "BUTTON_RELEASE_CB", (Icallback)internal_cb_BUTTON_RELEASE_CB_d);

void
_init_cb_MOUSEMOVE_CB_d(ih)
		Ihandle* ih;
	CODE:
		IupSetCallback(ih, "MOUSEMOVE_CB", (Icallback)internal_cb_MOUSEMOVE_CB_d);

void
_init_cb_EXTRABUTTON_CB_ii(ih)
		Ihandle* ih;
	CODE:
		IupSetCallback(ih, "EXTRABUTTON_CB", (Icallback)internal_cb_EXTRABUTTON_CB_ii);

void
_init_cb_OPENCLOSE_CB_i(ih)
		Ihandle* ih;
	CODE:
		IupSetCallback(ih, "OPENCLOSE_CB", (Icallback)internal_cb_OPENCLOSE_CB_i);

void
_init_cb_FILE_CB_ss(ih)
		Ihandle* ih;
	CODE:
		IupSetCallback(ih, "FILE_CB", (Icallback)internal_cb_FILE_CB_ss);

void
_init_cb_FLAT_ACTION_(ih)
		Ihandle* ih;
	CODE:
		IupSetCallback(ih, "FLAT_ACTION", (Icallback)internal_cb_FLAT_ACTION_);

void
_init_cb_FLAT_BUTTON_CB_iiiis(ih)
		Ihandle* ih;
	CODE:
		IupSetCallback(ih, "FLAT_BUTTON_CB", (Icallback)internal_cb_FLAT_BUTTON_CB_iiiis);

void
_init_cb_FLAT_ENTERWINDOW_CB_ii(ih)
		Ihandle* ih;
	CODE:
		IupSetCallback(ih, "FLAT_ENTERWINDOW_CB", (Icallback)internal_cb_FLAT_ENTERWINDOW_CB_ii);

void
_init_cb_FLAT_FOCUS_CB_i(ih)
		Ihandle* ih;
	CODE:
		IupSetCallback(ih, "FLAT_FOCUS_CB", (Icallback)internal_cb_FLAT_FOCUS_CB_i);

void
_init_cb_FLAT_LEAVEWINDOW_CB_(ih)
		Ihandle* ih;
	CODE:
		IupSetCallback(ih, "FLAT_LEAVEWINDOW_CB", (Icallback)internal_cb_FLAT_LEAVEWINDOW_CB_);

void
_init_cb_MOVE_CB_ii(ih)
		Ihandle* ih;
	CODE:
		IupSetCallback(ih, "MOVE_CB", (Icallback)internal_cb_MOVE_CB_ii);

void
_init_cb_ACTION_s(ih)
		Ihandle* ih;
	CODE:
		IupSetCallback(ih, "ACTION", (Icallback)internal_cb_ACTION_s);

void
_init_cb_GL_ACTION_(ih)
		Ihandle* ih;
	CODE:
		IupSetCallback(ih, "GL_ACTION", (Icallback)internal_cb_GL_ACTION_);

void
_init_cb_GL_BUTTON_CB_iiiis(ih)
		Ihandle* ih;
	CODE:
		IupSetCallback(ih, "GL_BUTTON_CB", (Icallback)internal_cb_GL_BUTTON_CB_iiiis);

void
_init_cb_GL_ENTERWINDOW_CB_ii(ih)
		Ihandle* ih;
	CODE:
		IupSetCallback(ih, "GL_ENTERWINDOW_CB", (Icallback)internal_cb_GL_ENTERWINDOW_CB_ii);

void
_init_cb_GL_LEAVEWINDOW_CB_(ih)
		Ihandle* ih;
	CODE:
		IupSetCallback(ih, "GL_LEAVEWINDOW_CB", (Icallback)internal_cb_GL_LEAVEWINDOW_CB_);

void
_init_cb_GL_MOTION_CB_iis(ih)
		Ihandle* ih;
	CODE:
		IupSetCallback(ih, "GL_MOTION_CB", (Icallback)internal_cb_GL_MOTION_CB_iis);

void
_init_cb_GL_WHEEL_CB_fiis(ih)
		Ihandle* ih;
	CODE:
		IupSetCallback(ih, "GL_WHEEL_CB", (Icallback)internal_cb_GL_WHEEL_CB_fiis);

void
_init_cb_ACTION_i(ih)
		Ihandle* ih;
	CODE:
		IupSetCallback(ih, "ACTION", (Icallback)internal_cb_ACTION_i);

void
_init_cb_VALUECHANGING_CB_i(ih)
		Ihandle* ih;
	CODE:
		IupSetCallback(ih, "VALUECHANGING_CB", (Icallback)internal_cb_VALUECHANGING_CB_i);

void
_init_cb_HIGHLIGHT_CB_(ih)
		Ihandle* ih;
	CODE:
		IupSetCallback(ih, "HIGHLIGHT_CB", (Icallback)internal_cb_HIGHLIGHT_CB_);

void
_init_cb_ACTION_sii(ih)
		Ihandle* ih;
	CODE:
		IupSetCallback(ih, "ACTION", (Icallback)internal_cb_ACTION_sii);

void
_init_cb_CARET_CB_iii(ih)
		Ihandle* ih;
	CODE:
		IupSetCallback(ih, "CARET_CB", (Icallback)internal_cb_CARET_CB_iii);

void
_init_cb_DBLCLICK_CB_is(ih)
		Ihandle* ih;
	CODE:
		IupSetCallback(ih, "DBLCLICK_CB", (Icallback)internal_cb_DBLCLICK_CB_is);

void
_init_cb_DRAGDROP_CB_iiii(ih)
		Ihandle* ih;
	CODE:
		IupSetCallback(ih, "DRAGDROP_CB", (Icallback)internal_cb_DRAGDROP_CB_iiii);

void
_init_cb_DROPDOWN_CB_i(ih)
		Ihandle* ih;
	CODE:
		IupSetCallback(ih, "DROPDOWN_CB", (Icallback)internal_cb_DROPDOWN_CB_i);

void
_init_cb_EDIT_CB_is(ih)
		Ihandle* ih;
	CODE:
		IupSetCallback(ih, "EDIT_CB", (Icallback)internal_cb_EDIT_CB_is);

void
_init_cb_MOTION_CB_iis(ih)
		Ihandle* ih;
	CODE:
		IupSetCallback(ih, "MOTION_CB", (Icallback)internal_cb_MOTION_CB_iis);

void
_init_cb_MULTISELECT_CB_s(ih)
		Ihandle* ih;
	CODE:
		IupSetCallback(ih, "MULTISELECT_CB", (Icallback)internal_cb_MULTISELECT_CB_s);

void
_init_cb_ACTION_CB_iiiis(ih)
		Ihandle* ih;
	CODE:
		IupSetCallback(ih, "ACTION_CB", (Icallback)internal_cb_ACTION_CB_iiiis);

void
_init_cb_BGCOLOR_CB_iiIII(ih)
		Ihandle* ih;
	CODE:
		IupSetCallback(ih, "BGCOLOR_CB", (Icallback)internal_cb_BGCOLOR_CB_iiIII);

void
_init_cb_BUSY_CB_iis(ih)
		Ihandle* ih;
	CODE:
		IupSetCallback(ih, "BUSY_CB", (Icallback)internal_cb_BUSY_CB_iis);

void
_init_cb_CLICK_CB_iis(ih)
		Ihandle* ih;
	CODE:
		IupSetCallback(ih, "CLICK_CB", (Icallback)internal_cb_CLICK_CB_iis);

void
_init_cb_COLRESIZE_CB_i(ih)
		Ihandle* ih;
	CODE:
		IupSetCallback(ih, "COLRESIZE_CB", (Icallback)internal_cb_COLRESIZE_CB_i);

void
_init_cb_DROPCHECK_CB_ii(ih)
		Ihandle* ih;
	CODE:
		IupSetCallback(ih, "DROPCHECK_CB", (Icallback)internal_cb_DROPCHECK_CB_ii);

void
_init_cb_DROPSELECT_CB_iinsii(ih)
		Ihandle* ih;
	CODE:
		IupSetCallback(ih, "DROPSELECT_CB", (Icallback)internal_cb_DROPSELECT_CB_iinsii);

void
_init_cb_DROP_CB_nii(ih)
		Ihandle* ih;
	CODE:
		IupSetCallback(ih, "DROP_CB", (Icallback)internal_cb_DROP_CB_nii);

void
_init_cb_EDITCLICK_CB_iis(ih)
		Ihandle* ih;
	CODE:
		IupSetCallback(ih, "EDITCLICK_CB", (Icallback)internal_cb_EDITCLICK_CB_iis);

void
_init_cb_EDITION_CB_iiii(ih)
		Ihandle* ih;
	CODE:
		IupSetCallback(ih, "EDITION_CB", (Icallback)internal_cb_EDITION_CB_iiii);

void
_init_cb_EDITMOUSEMOVE_CB_ii(ih)
		Ihandle* ih;
	CODE:
		IupSetCallback(ih, "EDITMOUSEMOVE_CB", (Icallback)internal_cb_EDITMOUSEMOVE_CB_ii);

void
_init_cb_EDITRELEASE_CB_iis(ih)
		Ihandle* ih;
	CODE:
		IupSetCallback(ih, "EDITRELEASE_CB", (Icallback)internal_cb_EDITRELEASE_CB_iis);

void
_init_cb_ENTERITEM_CB_ii(ih)
		Ihandle* ih;
	CODE:
		IupSetCallback(ih, "ENTERITEM_CB", (Icallback)internal_cb_ENTERITEM_CB_ii);

void
_init_cb_FGCOLOR_CB_iiIII(ih)
		Ihandle* ih;
	CODE:
		IupSetCallback(ih, "FGCOLOR_CB", (Icallback)internal_cb_FGCOLOR_CB_iiIII);

void
_init_cb_FONT_CB_ii(ih)
		Ihandle* ih;
	CODE:
		IupSetCallback(ih, "FONT_CB", (Icallback)internal_cb_FONT_CB_ii);

void
_init_cb_LEAVEITEM_CB_ii(ih)
		Ihandle* ih;
	CODE:
		IupSetCallback(ih, "LEAVEITEM_CB", (Icallback)internal_cb_LEAVEITEM_CB_ii);

void
_init_cb_MARKEDIT_CB_iii(ih)
		Ihandle* ih;
	CODE:
		IupSetCallback(ih, "MARKEDIT_CB", (Icallback)internal_cb_MARKEDIT_CB_iii);

void
_init_cb_MARK_CB_ii(ih)
		Ihandle* ih;
	CODE:
		IupSetCallback(ih, "MARK_CB", (Icallback)internal_cb_MARK_CB_ii);

void
_init_cb_MENUCONTEXTCLOSE_CB_nii(ih)
		Ihandle* ih;
	CODE:
		IupSetCallback(ih, "MENUCONTEXTCLOSE_CB", (Icallback)internal_cb_MENUCONTEXTCLOSE_CB_nii);

void
_init_cb_MENUCONTEXT_CB_nii(ih)
		Ihandle* ih;
	CODE:
		IupSetCallback(ih, "MENUCONTEXT_CB", (Icallback)internal_cb_MENUCONTEXT_CB_nii);

void
_init_cb_MENUDROP_CB_nii(ih)
		Ihandle* ih;
	CODE:
		IupSetCallback(ih, "MENUDROP_CB", (Icallback)internal_cb_MENUDROP_CB_nii);

void
_init_cb_MOUSEMOVE_CB_ii(ih)
		Ihandle* ih;
	CODE:
		IupSetCallback(ih, "MOUSEMOVE_CB", (Icallback)internal_cb_MOUSEMOVE_CB_ii);

void
_init_cb_NUMERICGETVALUE_CB_ii(ih)
		Ihandle* ih;
	CODE:
		IupSetCallback(ih, "NUMERICGETVALUE_CB", (Icallback)internal_cb_NUMERICGETVALUE_CB_ii);

void
_init_cb_NUMERICSETVALUE_CB_iid(ih)
		Ihandle* ih;
	CODE:
		IupSetCallback(ih, "NUMERICSETVALUE_CB", (Icallback)internal_cb_NUMERICSETVALUE_CB_iid);

void
_init_cb_PASTESIZE_CB_ii(ih)
		Ihandle* ih;
	CODE:
		IupSetCallback(ih, "PASTESIZE_CB", (Icallback)internal_cb_PASTESIZE_CB_ii);

void
_init_cb_RELEASE_CB_iis(ih)
		Ihandle* ih;
	CODE:
		IupSetCallback(ih, "RELEASE_CB", (Icallback)internal_cb_RELEASE_CB_iis);

void
_init_cb_RESIZEMATRIX_CB_ii(ih)
		Ihandle* ih;
	CODE:
		IupSetCallback(ih, "RESIZEMATRIX_CB", (Icallback)internal_cb_RESIZEMATRIX_CB_ii);

void
_init_cb_SCROLLTOP_CB_ii(ih)
		Ihandle* ih;
	CODE:
		IupSetCallback(ih, "SCROLLTOP_CB", (Icallback)internal_cb_SCROLLTOP_CB_ii);

void
_init_cb_SORTCOLUMNCOMPARE_CB_iii(ih)
		Ihandle* ih;
	CODE:
		IupSetCallback(ih, "SORTCOLUMNCOMPARE_CB", (Icallback)internal_cb_SORTCOLUMNCOMPARE_CB_iii);

void
_init_cb_TOGGLEVALUE_CB_iii(ih)
		Ihandle* ih;
	CODE:
		IupSetCallback(ih, "TOGGLEVALUE_CB", (Icallback)internal_cb_TOGGLEVALUE_CB_iii);

void
_init_cb_TRANSLATEVALUE_CB_iis(ih)
		Ihandle* ih;
	CODE:
		IupSetCallback(ih, "TRANSLATEVALUE_CB", (Icallback)internal_cb_TRANSLATEVALUE_CB_iis);

void
_init_cb_TYPE_CB_ii(ih)
		Ihandle* ih;
	CODE:
		IupSetCallback(ih, "TYPE_CB", (Icallback)internal_cb_TYPE_CB_ii);

void
_init_cb_VALUE_CB_ii(ih)
		Ihandle* ih;
	CODE:
		IupSetCallback(ih, "VALUE_CB", (Icallback)internal_cb_VALUE_CB_ii);

void
_init_cb_VALUE_EDIT_CB_iis(ih)
		Ihandle* ih;
	CODE:
		IupSetCallback(ih, "VALUE_EDIT_CB", (Icallback)internal_cb_VALUE_EDIT_CB_iis);

void
_init_cb_IMAGEVALUECHANGED_CB_ii(ih)
		Ihandle* ih;
	CODE:
		IupSetCallback(ih, "IMAGEVALUECHANGED_CB", (Icallback)internal_cb_IMAGEVALUECHANGED_CB_ii);

void
_init_cb_LISTACTION_CB_ii(ih)
		Ihandle* ih;
	CODE:
		IupSetCallback(ih, "LISTACTION_CB", (Icallback)internal_cb_LISTACTION_CB_ii);

void
_init_cb_LISTCLICK_CB_iis(ih)
		Ihandle* ih;
	CODE:
		IupSetCallback(ih, "LISTCLICK_CB", (Icallback)internal_cb_LISTCLICK_CB_iis);

void
_init_cb_LISTDRAW_CB_iiiiiiv(ih)
		Ihandle* ih;
	CODE:
		IupSetCallback(ih, "LISTDRAW_CB", (Icallback)internal_cb_LISTDRAW_CB_iiiiiiv);

void
_init_cb_LISTEDITION_CB_iiii(ih)
		Ihandle* ih;
	CODE:
		IupSetCallback(ih, "LISTEDITION_CB", (Icallback)internal_cb_LISTEDITION_CB_iiii);

void
_init_cb_LISTINSERT_CB_i(ih)
		Ihandle* ih;
	CODE:
		IupSetCallback(ih, "LISTINSERT_CB", (Icallback)internal_cb_LISTINSERT_CB_i);

void
_init_cb_LISTRELEASE_CB_iis(ih)
		Ihandle* ih;
	CODE:
		IupSetCallback(ih, "LISTRELEASE_CB", (Icallback)internal_cb_LISTRELEASE_CB_iis);

void
_init_cb_LISTREMOVE_CB_i(ih)
		Ihandle* ih;
	CODE:
		IupSetCallback(ih, "LISTREMOVE_CB", (Icallback)internal_cb_LISTREMOVE_CB_i);

void
_init_cb_MENUCLOSE_CB_(ih)
		Ihandle* ih;
	CODE:
		IupSetCallback(ih, "MENUCLOSE_CB", (Icallback)internal_cb_MENUCLOSE_CB_);

void
_init_cb_OPEN_CB_(ih)
		Ihandle* ih;
	CODE:
		IupSetCallback(ih, "OPEN_CB", (Icallback)internal_cb_OPEN_CB_);

void
_init_cb_POSTDRAW_CB_v(ih)
		Ihandle* ih;
	CODE:
		IupSetCallback(ih, "POSTDRAW_CB", (Icallback)internal_cb_POSTDRAW_CB_v);

void
_init_cb_PREDRAW_CB_v(ih)
		Ihandle* ih;
	CODE:
		IupSetCallback(ih, "PREDRAW_CB", (Icallback)internal_cb_PREDRAW_CB_v);

void
_init_cb_CLICKSAMPLE_CB_iiddi(ih)
		Ihandle* ih;
	CODE:
		IupSetCallback(ih, "CLICKSAMPLE_CB", (Icallback)internal_cb_CLICKSAMPLE_CB_iiddi);

void
_init_cb_DELETEBEGIN_CB_(ih)
		Ihandle* ih;
	CODE:
		IupSetCallback(ih, "DELETEBEGIN_CB", (Icallback)internal_cb_DELETEBEGIN_CB_);

void
_init_cb_DELETEEND_CB_(ih)
		Ihandle* ih;
	CODE:
		IupSetCallback(ih, "DELETEEND_CB", (Icallback)internal_cb_DELETEEND_CB_);

void
_init_cb_DELETE_CB_iidd(ih)
		Ihandle* ih;
	CODE:
		IupSetCallback(ih, "DELETE_CB", (Icallback)internal_cb_DELETE_CB_iidd);

void
_init_cb_DRAWSAMPLE_CB_iiddi(ih)
		Ihandle* ih;
	CODE:
		IupSetCallback(ih, "DRAWSAMPLE_CB", (Icallback)internal_cb_DRAWSAMPLE_CB_iiddi);

void
_init_cb_PLOTBUTTON_CB_iidds(ih)
		Ihandle* ih;
	CODE:
		IupSetCallback(ih, "PLOTBUTTON_CB", (Icallback)internal_cb_PLOTBUTTON_CB_iidds);

void
_init_cb_PLOTMOTION_CB_dds(ih)
		Ihandle* ih;
	CODE:
		IupSetCallback(ih, "PLOTMOTION_CB", (Icallback)internal_cb_PLOTMOTION_CB_dds);

void
_init_cb_SELECTBEGIN_CB_(ih)
		Ihandle* ih;
	CODE:
		IupSetCallback(ih, "SELECTBEGIN_CB", (Icallback)internal_cb_SELECTBEGIN_CB_);

void
_init_cb_SELECTEND_CB_(ih)
		Ihandle* ih;
	CODE:
		IupSetCallback(ih, "SELECTEND_CB", (Icallback)internal_cb_SELECTEND_CB_);

void
_init_cb_SELECT_CB_iiddi(ih)
		Ihandle* ih;
	CODE:
		IupSetCallback(ih, "SELECT_CB", (Icallback)internal_cb_SELECT_CB_iiddi);

void
_init_cb_CANCEL_CB_(ih)
		Ihandle* ih;
	CODE:
		IupSetCallback(ih, "CANCEL_CB", (Icallback)internal_cb_CANCEL_CB_);

void
_init_cb_ACTION_iiis(ih)
		Ihandle* ih;
	CODE:
		IupSetCallback(ih, "ACTION", (Icallback)internal_cb_ACTION_iiis);

void
_init_cb_AUTOCCANCELLED_CB_(ih)
		Ihandle* ih;
	CODE:
		IupSetCallback(ih, "AUTOCCANCELLED_CB", (Icallback)internal_cb_AUTOCCANCELLED_CB_);

void
_init_cb_AUTOCCHARDELETED_CB_(ih)
		Ihandle* ih;
	CODE:
		IupSetCallback(ih, "AUTOCCHARDELETED_CB", (Icallback)internal_cb_AUTOCCHARDELETED_CB_);

void
_init_cb_AUTOCSELECTION_CB_is(ih)
		Ihandle* ih;
	CODE:
		IupSetCallback(ih, "AUTOCSELECTION_CB", (Icallback)internal_cb_AUTOCSELECTION_CB_is);

void
_init_cb_DROPFILES_CB_siii(ih)
		Ihandle* ih;
	CODE:
		IupSetCallback(ih, "DROPFILES_CB", (Icallback)internal_cb_DROPFILES_CB_siii);

void
_init_cb_HOTSPOTCLICK_CB_iiis(ih)
		Ihandle* ih;
	CODE:
		IupSetCallback(ih, "HOTSPOTCLICK_CB", (Icallback)internal_cb_HOTSPOTCLICK_CB_iiis);

void
_init_cb_MARGINCLICK_CB_iis(ih)
		Ihandle* ih;
	CODE:
		IupSetCallback(ih, "MARGINCLICK_CB", (Icallback)internal_cb_MARGINCLICK_CB_iis);

void
_init_cb_SAVEPOINT_CB_i(ih)
		Ihandle* ih;
	CODE:
		IupSetCallback(ih, "SAVEPOINT_CB", (Icallback)internal_cb_SAVEPOINT_CB_i);

void
_init_cb_ZOOM_CB_i(ih)
		Ihandle* ih;
	CODE:
		IupSetCallback(ih, "ZOOM_CB", (Icallback)internal_cb_ZOOM_CB_i);

void
_init_cb_SPIN_CB_i(ih)
		Ihandle* ih;
	CODE:
		IupSetCallback(ih, "SPIN_CB", (Icallback)internal_cb_SPIN_CB_i);

void
_init_cb_RIGHTCLICK_CB_i(ih)
		Ihandle* ih;
	CODE:
		IupSetCallback(ih, "RIGHTCLICK_CB", (Icallback)internal_cb_RIGHTCLICK_CB_i);

void
_init_cb_TABCHANGEPOS_CB_ii(ih)
		Ihandle* ih;
	CODE:
		IupSetCallback(ih, "TABCHANGEPOS_CB", (Icallback)internal_cb_TABCHANGEPOS_CB_ii);

void
_init_cb_TABCHANGE_CB_nn(ih)
		Ihandle* ih;
	CODE:
		IupSetCallback(ih, "TABCHANGE_CB", (Icallback)internal_cb_TABCHANGE_CB_nn);

void
_init_cb_TABCLOSE_CB_i(ih)
		Ihandle* ih;
	CODE:
		IupSetCallback(ih, "TABCLOSE_CB", (Icallback)internal_cb_TABCLOSE_CB_i);

void
_init_cb_ACTION_is(ih)
		Ihandle* ih;
	CODE:
		IupSetCallback(ih, "ACTION", (Icallback)internal_cb_ACTION_is);

void
_init_cb_ACTION_CB_(ih)
		Ihandle* ih;
	CODE:
		IupSetCallback(ih, "ACTION_CB", (Icallback)internal_cb_ACTION_CB_);

void
_init_cb_BRANCHCLOSE_CB_i(ih)
		Ihandle* ih;
	CODE:
		IupSetCallback(ih, "BRANCHCLOSE_CB", (Icallback)internal_cb_BRANCHCLOSE_CB_i);

void
_init_cb_BRANCHOPEN_CB_i(ih)
		Ihandle* ih;
	CODE:
		IupSetCallback(ih, "BRANCHOPEN_CB", (Icallback)internal_cb_BRANCHOPEN_CB_i);

void
_init_cb_EXECUTELEAF_CB_i(ih)
		Ihandle* ih;
	CODE:
		IupSetCallback(ih, "EXECUTELEAF_CB", (Icallback)internal_cb_EXECUTELEAF_CB_i);

void
_init_cb_MULTISELECTION_CB_Ai(ih)
		Ihandle* ih;
	CODE:
		IupSetCallback(ih, "MULTISELECTION_CB", (Icallback)internal_cb_MULTISELECTION_CB_Ai);

void
_init_cb_MULTIUNSELECTION_CB_Ai(ih)
		Ihandle* ih;
	CODE:
		IupSetCallback(ih, "MULTIUNSELECTION_CB", (Icallback)internal_cb_MULTIUNSELECTION_CB_Ai);

void
_init_cb_NODEREMOVED_CB_U(ih)
		Ihandle* ih;
	CODE:
		IupSetCallback(ih, "NODEREMOVED_CB", (Icallback)internal_cb_NODEREMOVED_CB_U);

void
_init_cb_RENAME_CB_is(ih)
		Ihandle* ih;
	CODE:
		IupSetCallback(ih, "RENAME_CB", (Icallback)internal_cb_RENAME_CB_is);

void
_init_cb_SELECTION_CB_ii(ih)
		Ihandle* ih;
	CODE:
		IupSetCallback(ih, "SELECTION_CB", (Icallback)internal_cb_SELECTION_CB_ii);

void
_init_cb_SHOWRENAME_CB_i(ih)
		Ihandle* ih;
	CODE:
		IupSetCallback(ih, "SHOWRENAME_CB", (Icallback)internal_cb_SHOWRENAME_CB_i);

void
_init_cb_TOGGLEVALUE_CB_ii(ih)
		Ihandle* ih;
	CODE:
		IupSetCallback(ih, "TOGGLEVALUE_CB", (Icallback)internal_cb_TOGGLEVALUE_CB_ii);

void
_init_cb_ENTERWINDOW_CB_(ih)
		Ihandle* ih;
	CODE:
		IupSetCallback(ih, "ENTERWINDOW_CB", (Icallback)internal_cb_ENTERWINDOW_CB_);

void
_init_cb_GETFOCUS_CB_(ih)
		Ihandle* ih;
	CODE:
		IupSetCallback(ih, "GETFOCUS_CB", (Icallback)internal_cb_GETFOCUS_CB_);

void
_init_cb_HELP_CB_(ih)
		Ihandle* ih;
	CODE:
		IupSetCallback(ih, "HELP_CB", (Icallback)internal_cb_HELP_CB_);

void
_init_cb_KILLFOCUS_CB_(ih)
		Ihandle* ih;
	CODE:
		IupSetCallback(ih, "KILLFOCUS_CB", (Icallback)internal_cb_KILLFOCUS_CB_);

void
_init_cb_K_ANY_i(ih)
		Ihandle* ih;
	CODE:
		IupSetCallback(ih, "K_ANY", (Icallback)internal_cb_K_ANY_i);

void
_init_cb_LEAVEWINDOW_CB_(ih)
		Ihandle* ih;
	CODE:
		IupSetCallback(ih, "LEAVEWINDOW_CB", (Icallback)internal_cb_LEAVEWINDOW_CB_);

void
_init_cb_MAP_CB_(ih)
		Ihandle* ih;
	CODE:
		IupSetCallback(ih, "MAP_CB", (Icallback)internal_cb_MAP_CB_);

void
_init_cb_TIPS_CB_ii(ih)
		Ihandle* ih;
	CODE:
		IupSetCallback(ih, "TIPS_CB", (Icallback)internal_cb_TIPS_CB_ii);

void
_init_cb_UNMAP_CB_(ih)
		Ihandle* ih;
	CODE:
		IupSetCallback(ih, "UNMAP_CB", (Icallback)internal_cb_UNMAP_CB_);

void
_init_cb_ACTION_ff(ih)
		Ihandle* ih;
	CODE:
		IupSetCallback(ih, "ACTION", (Icallback)internal_cb_ACTION_ff);

void
_init_cb_FOCUS_CB_i(ih)
		Ihandle* ih;
	CODE:
		IupSetCallback(ih, "FOCUS_CB", (Icallback)internal_cb_FOCUS_CB_i);

void
_init_cb_KEYPRESS_CB_ii(ih)
		Ihandle* ih;
	CODE:
		IupSetCallback(ih, "KEYPRESS_CB", (Icallback)internal_cb_KEYPRESS_CB_ii);

void
_init_cb_MULTITOUCH_CB_iAAAA(ih)
		Ihandle* ih;
	CODE:
		IupSetCallback(ih, "MULTITOUCH_CB", (Icallback)internal_cb_MULTITOUCH_CB_iAAAA);

void
_init_cb_RESIZE_CB_ii(ih)
		Ihandle* ih;
	CODE:
		IupSetCallback(ih, "RESIZE_CB", (Icallback)internal_cb_RESIZE_CB_ii);

void
_init_cb_SCROLL_CB_iff(ih)
		Ihandle* ih;
	CODE:
		IupSetCallback(ih, "SCROLL_CB", (Icallback)internal_cb_SCROLL_CB_iff);

void
_init_cb_TOUCH_CB_iiis(ih)
		Ihandle* ih;
	CODE:
		IupSetCallback(ih, "TOUCH_CB", (Icallback)internal_cb_TOUCH_CB_iiis);

void
_init_cb_WHEEL_CB_fiis(ih)
		Ihandle* ih;
	CODE:
		IupSetCallback(ih, "WHEEL_CB", (Icallback)internal_cb_WHEEL_CB_fiis);

void
_init_cb_WOM_CB_i(ih)
		Ihandle* ih;
	CODE:
		IupSetCallback(ih, "WOM_CB", (Icallback)internal_cb_WOM_CB_i);

void
_init_cb_CLOSE_CB_(ih)
		Ihandle* ih;
	CODE:
		IupSetCallback(ih, "CLOSE_CB", (Icallback)internal_cb_CLOSE_CB_);

void
_init_cb_COPYDATA_CB_si(ih)
		Ihandle* ih;
	CODE:
		IupSetCallback(ih, "COPYDATA_CB", (Icallback)internal_cb_COPYDATA_CB_si);

void
_init_cb_CUSTOMFRAME_CB_(ih)
		Ihandle* ih;
	CODE:
		IupSetCallback(ih, "CUSTOMFRAME_CB", (Icallback)internal_cb_CUSTOMFRAME_CB_);

void
_init_cb_MDIACTIVATE_CB_(ih)
		Ihandle* ih;
	CODE:
		IupSetCallback(ih, "MDIACTIVATE_CB", (Icallback)internal_cb_MDIACTIVATE_CB_);

void
_init_cb_SHOW_CB_i(ih)
		Ihandle* ih;
	CODE:
		IupSetCallback(ih, "SHOW_CB", (Icallback)internal_cb_SHOW_CB_i);

void
_init_cb_TRAYCLICK_CB_iii(ih)
		Ihandle* ih;
	CODE:
		IupSetCallback(ih, "TRAYCLICK_CB", (Icallback)internal_cb_TRAYCLICK_CB_iii);

void
_init_cb_DRAGBEGIN_CB_ii(ih)
		Ihandle* ih;
	CODE:
		IupSetCallback(ih, "DRAGBEGIN_CB", (Icallback)internal_cb_DRAGBEGIN_CB_ii);

void
_init_cb_DRAGDATASIZE_CB_s(ih)
		Ihandle* ih;
	CODE:
		IupSetCallback(ih, "DRAGDATASIZE_CB", (Icallback)internal_cb_DRAGDATASIZE_CB_s);

void
_init_cb_DRAGDATA_CB_sUi(ih)
		Ihandle* ih;
	CODE:
		IupSetCallback(ih, "DRAGDATA_CB", (Icallback)internal_cb_DRAGDATA_CB_sUi);

void
_init_cb_DRAGEND_CB_i(ih)
		Ihandle* ih;
	CODE:
		IupSetCallback(ih, "DRAGEND_CB", (Icallback)internal_cb_DRAGEND_CB_i);

void
_init_cb_DROPDATA_CB_sUiii(ih)
		Ihandle* ih;
	CODE:
		IupSetCallback(ih, "DROPDATA_CB", (Icallback)internal_cb_DROPDATA_CB_sUiii);

void
_init_cb_DROPMOTION_CB_iis(ih)
		Ihandle* ih;
	CODE:
		IupSetCallback(ih, "DROPMOTION_CB", (Icallback)internal_cb_DROPMOTION_CB_iis);

