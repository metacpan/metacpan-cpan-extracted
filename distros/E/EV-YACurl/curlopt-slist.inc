#if LIBCURL_HAS(CURLOPT_HTTPHEADER)
    case CURLOPT_HTTPHEADER:
#endif
#if LIBCURL_HAS(CURLOPT_QUOTE)
    case CURLOPT_QUOTE:
#endif
#if LIBCURL_HAS(CURLOPT_POSTQUOTE)
    case CURLOPT_POSTQUOTE:
#endif
#if LIBCURL_HAS(CURLOPT_TELNETOPTIONS)
    case CURLOPT_TELNETOPTIONS:
#endif
#if LIBCURL_HAS(CURLOPT_PREQUOTE)
    case CURLOPT_PREQUOTE:
#endif
#if LIBCURL_HAS(CURLOPT_HTTP200ALIASES)
    case CURLOPT_HTTP200ALIASES:
#endif
#if LIBCURL_HAS(CURLOPT_MAIL_RCPT)
    case CURLOPT_MAIL_RCPT:
#endif
#if LIBCURL_HAS(CURLOPT_RESOLVE)
    case CURLOPT_RESOLVE:
#endif
#if LIBCURL_HAS(CURLOPT_PROXYHEADER)
    case CURLOPT_PROXYHEADER:
#endif
#if LIBCURL_HAS(CURLOPT_CONNECT_TO)
    case CURLOPT_CONNECT_TO:
#endif
