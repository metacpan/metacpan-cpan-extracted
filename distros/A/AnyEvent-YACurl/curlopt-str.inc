#if LIBCURL_HAS(CURLOPT_URL)
    case CURLOPT_URL:
#endif
#if LIBCURL_HAS(CURLOPT_PROXY)
    case CURLOPT_PROXY:
#endif
#if LIBCURL_HAS(CURLOPT_USERPWD)
    case CURLOPT_USERPWD:
#endif
#if LIBCURL_HAS(CURLOPT_PROXYUSERPWD)
    case CURLOPT_PROXYUSERPWD:
#endif
#if LIBCURL_HAS(CURLOPT_RANGE)
    case CURLOPT_RANGE:
#endif
#if LIBCURL_HAS(CURLOPT_REFERER)
    case CURLOPT_REFERER:
#endif
#if LIBCURL_HAS(CURLOPT_FTPPORT)
    case CURLOPT_FTPPORT:
#endif
#if LIBCURL_HAS(CURLOPT_USERAGENT)
    case CURLOPT_USERAGENT:
#endif
#if LIBCURL_HAS(CURLOPT_COOKIE)
    case CURLOPT_COOKIE:
#endif
#if LIBCURL_HAS(CURLOPT_SSLCERT)
    case CURLOPT_SSLCERT:
#endif
#if LIBCURL_HAS(CURLOPT_KEYPASSWD)
    case CURLOPT_KEYPASSWD:
#endif
#if LIBCURL_HAS(CURLOPT_COOKIEFILE)
    case CURLOPT_COOKIEFILE:
#endif
#if LIBCURL_HAS(CURLOPT_CUSTOMREQUEST)
    case CURLOPT_CUSTOMREQUEST:
#endif
#if LIBCURL_HAS(CURLOPT_INTERFACE)
    case CURLOPT_INTERFACE:
#endif
#if LIBCURL_HAS(CURLOPT_KRBLEVEL)
    case CURLOPT_KRBLEVEL:
#endif
#if LIBCURL_HAS(CURLOPT_CAINFO)
    case CURLOPT_CAINFO:
#endif
#if LIBCURL_HAS(CURLOPT_RANDOM_FILE)
    case CURLOPT_RANDOM_FILE:
#endif
#if LIBCURL_HAS(CURLOPT_EGDSOCKET)
    case CURLOPT_EGDSOCKET:
#endif
#if LIBCURL_HAS(CURLOPT_COOKIEJAR)
    case CURLOPT_COOKIEJAR:
#endif
#if LIBCURL_HAS(CURLOPT_SSL_CIPHER_LIST)
    case CURLOPT_SSL_CIPHER_LIST:
#endif
#if LIBCURL_HAS(CURLOPT_SSLCERTTYPE)
    case CURLOPT_SSLCERTTYPE:
#endif
#if LIBCURL_HAS(CURLOPT_SSLKEY)
    case CURLOPT_SSLKEY:
#endif
#if LIBCURL_HAS(CURLOPT_SSLKEYTYPE)
    case CURLOPT_SSLKEYTYPE:
#endif
#if LIBCURL_HAS(CURLOPT_SSLENGINE)
    case CURLOPT_SSLENGINE:
#endif
#if LIBCURL_HAS(CURLOPT_CAPATH)
    case CURLOPT_CAPATH:
#endif
#if LIBCURL_HAS(CURLOPT_ACCEPT_ENCODING)
    case CURLOPT_ACCEPT_ENCODING:
#endif
#if LIBCURL_HAS(CURLOPT_NETRC_FILE)
    case CURLOPT_NETRC_FILE:
#endif
#if LIBCURL_HAS(CURLOPT_FTP_ACCOUNT)
    case CURLOPT_FTP_ACCOUNT:
#endif
#if LIBCURL_HAS(CURLOPT_COOKIELIST)
    case CURLOPT_COOKIELIST:
#endif
#if LIBCURL_HAS(CURLOPT_FTP_ALTERNATIVE_TO_USER)
    case CURLOPT_FTP_ALTERNATIVE_TO_USER:
#endif
#if LIBCURL_HAS(CURLOPT_SSH_PUBLIC_KEYFILE)
    case CURLOPT_SSH_PUBLIC_KEYFILE:
#endif
#if LIBCURL_HAS(CURLOPT_SSH_PRIVATE_KEYFILE)
    case CURLOPT_SSH_PRIVATE_KEYFILE:
#endif
#if LIBCURL_HAS(CURLOPT_SSH_HOST_PUBLIC_KEY_MD5)
    case CURLOPT_SSH_HOST_PUBLIC_KEY_MD5:
#endif
#if LIBCURL_HAS(CURLOPT_CRLFILE)
    case CURLOPT_CRLFILE:
#endif
#if LIBCURL_HAS(CURLOPT_ISSUERCERT)
    case CURLOPT_ISSUERCERT:
#endif
#if LIBCURL_HAS(CURLOPT_USERNAME)
    case CURLOPT_USERNAME:
#endif
#if LIBCURL_HAS(CURLOPT_PASSWORD)
    case CURLOPT_PASSWORD:
#endif
#if LIBCURL_HAS(CURLOPT_PROXYUSERNAME)
    case CURLOPT_PROXYUSERNAME:
#endif
#if LIBCURL_HAS(CURLOPT_PROXYPASSWORD)
    case CURLOPT_PROXYPASSWORD:
#endif
#if LIBCURL_HAS(CURLOPT_NOPROXY)
    case CURLOPT_NOPROXY:
#endif
#if LIBCURL_HAS(CURLOPT_SOCKS5_GSSAPI_SERVICE)
    case CURLOPT_SOCKS5_GSSAPI_SERVICE:
#endif
#if LIBCURL_HAS(CURLOPT_SSH_KNOWNHOSTS)
    case CURLOPT_SSH_KNOWNHOSTS:
#endif
#if LIBCURL_HAS(CURLOPT_MAIL_FROM)
    case CURLOPT_MAIL_FROM:
#endif
#if LIBCURL_HAS(CURLOPT_RTSP_SESSION_ID)
    case CURLOPT_RTSP_SESSION_ID:
#endif
#if LIBCURL_HAS(CURLOPT_RTSP_STREAM_URI)
    case CURLOPT_RTSP_STREAM_URI:
#endif
#if LIBCURL_HAS(CURLOPT_RTSP_TRANSPORT)
    case CURLOPT_RTSP_TRANSPORT:
#endif
#if LIBCURL_HAS(CURLOPT_TLSAUTH_USERNAME)
    case CURLOPT_TLSAUTH_USERNAME:
#endif
#if LIBCURL_HAS(CURLOPT_TLSAUTH_PASSWORD)
    case CURLOPT_TLSAUTH_PASSWORD:
#endif
#if LIBCURL_HAS(CURLOPT_TLSAUTH_TYPE)
    case CURLOPT_TLSAUTH_TYPE:
#endif
#if LIBCURL_HAS(CURLOPT_DNS_SERVERS)
    case CURLOPT_DNS_SERVERS:
#endif
#if LIBCURL_HAS(CURLOPT_MAIL_AUTH)
    case CURLOPT_MAIL_AUTH:
#endif
#if LIBCURL_HAS(CURLOPT_XOAUTH2_BEARER)
    case CURLOPT_XOAUTH2_BEARER:
#endif
#if LIBCURL_HAS(CURLOPT_DNS_INTERFACE)
    case CURLOPT_DNS_INTERFACE:
#endif
#if LIBCURL_HAS(CURLOPT_DNS_LOCAL_IP4)
    case CURLOPT_DNS_LOCAL_IP4:
#endif
#if LIBCURL_HAS(CURLOPT_DNS_LOCAL_IP6)
    case CURLOPT_DNS_LOCAL_IP6:
#endif
#if LIBCURL_HAS(CURLOPT_LOGIN_OPTIONS)
    case CURLOPT_LOGIN_OPTIONS:
#endif
#if LIBCURL_HAS(CURLOPT_PINNEDPUBLICKEY)
    case CURLOPT_PINNEDPUBLICKEY:
#endif
#if LIBCURL_HAS(CURLOPT_UNIX_SOCKET_PATH)
    case CURLOPT_UNIX_SOCKET_PATH:
#endif
#if LIBCURL_HAS(CURLOPT_PROXY_SERVICE_NAME)
    case CURLOPT_PROXY_SERVICE_NAME:
#endif
#if LIBCURL_HAS(CURLOPT_SERVICE_NAME)
    case CURLOPT_SERVICE_NAME:
#endif
#if LIBCURL_HAS(CURLOPT_DEFAULT_PROTOCOL)
    case CURLOPT_DEFAULT_PROTOCOL:
#endif
#if LIBCURL_HAS(CURLOPT_PROXY_CAINFO)
    case CURLOPT_PROXY_CAINFO:
#endif
#if LIBCURL_HAS(CURLOPT_PROXY_CAPATH)
    case CURLOPT_PROXY_CAPATH:
#endif
#if LIBCURL_HAS(CURLOPT_PROXY_TLSAUTH_USERNAME)
    case CURLOPT_PROXY_TLSAUTH_USERNAME:
#endif
#if LIBCURL_HAS(CURLOPT_PROXY_TLSAUTH_PASSWORD)
    case CURLOPT_PROXY_TLSAUTH_PASSWORD:
#endif
#if LIBCURL_HAS(CURLOPT_PROXY_TLSAUTH_TYPE)
    case CURLOPT_PROXY_TLSAUTH_TYPE:
#endif
#if LIBCURL_HAS(CURLOPT_PROXY_SSLCERT)
    case CURLOPT_PROXY_SSLCERT:
#endif
#if LIBCURL_HAS(CURLOPT_PROXY_SSLCERTTYPE)
    case CURLOPT_PROXY_SSLCERTTYPE:
#endif
#if LIBCURL_HAS(CURLOPT_PROXY_SSLKEY)
    case CURLOPT_PROXY_SSLKEY:
#endif
#if LIBCURL_HAS(CURLOPT_PROXY_SSLKEYTYPE)
    case CURLOPT_PROXY_SSLKEYTYPE:
#endif
#if LIBCURL_HAS(CURLOPT_PROXY_KEYPASSWD)
    case CURLOPT_PROXY_KEYPASSWD:
#endif
#if LIBCURL_HAS(CURLOPT_PROXY_SSL_CIPHER_LIST)
    case CURLOPT_PROXY_SSL_CIPHER_LIST:
#endif
#if LIBCURL_HAS(CURLOPT_PROXY_CRLFILE)
    case CURLOPT_PROXY_CRLFILE:
#endif
#if LIBCURL_HAS(CURLOPT_PRE_PROXY)
    case CURLOPT_PRE_PROXY:
#endif
#if LIBCURL_HAS(CURLOPT_PROXY_PINNEDPUBLICKEY)
    case CURLOPT_PROXY_PINNEDPUBLICKEY:
#endif
#if LIBCURL_HAS(CURLOPT_ABSTRACT_UNIX_SOCKET)
    case CURLOPT_ABSTRACT_UNIX_SOCKET:
#endif
#if LIBCURL_HAS(CURLOPT_REQUEST_TARGET)
    case CURLOPT_REQUEST_TARGET:
#endif
#if LIBCURL_HAS(CURLOPT_TLS13_CIPHERS)
    case CURLOPT_TLS13_CIPHERS:
#endif
#if LIBCURL_HAS(CURLOPT_PROXY_TLS13_CIPHERS)
    case CURLOPT_PROXY_TLS13_CIPHERS:
#endif
#if LIBCURL_HAS(CURLOPT_DOH_URL)
    case CURLOPT_DOH_URL:
#endif
#if LIBCURL_HAS(CURLOPT_ALTSVC)
    case CURLOPT_ALTSVC:
#endif
#if LIBCURL_HAS(CURLOPT_SASL_AUTHZID)
    case CURLOPT_SASL_AUTHZID:
#endif
#if LIBCURL_HAS(CURLOPT_PROXY_ISSUERCERT)
    case CURLOPT_PROXY_ISSUERCERT:
#endif
#if LIBCURL_HAS(CURLOPT_SSL_EC_CURVES)
    case CURLOPT_SSL_EC_CURVES:
#endif
#if LIBCURL_HAS(CURLOPT_HSTS)
    case CURLOPT_HSTS:
#endif
