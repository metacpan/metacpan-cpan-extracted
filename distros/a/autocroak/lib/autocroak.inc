UNDEFINED_FILE_WRAPPER(SYSOPEN, ST(1))
UNDEFINED_WRAPPER(CLOSE)
UNDEFINED_WRAPPER(TRUNCATE)
UNDEFINED_WRAPPER(EXEC)
UNDEFINED_WRAPPER(FORK)
UNDEFINED_WRAPPER(FCNTL)
UNDEFINED_WRAPPER(BINMODE)
UNDEFINED_WRAPPER(IOCTL)
UNDEFINED_WRAPPER(PIPE_OP)
UNDEFINED_WRAPPER(FLOCK)
NUMERIC_WRAPPER(KILL, 1)

UNDEFINED_WRAPPER(BIND)
UNDEFINED_WRAPPER(CONNECT)
UNDEFINED_WRAPPER(LISTEN)
UNDEFINED_WRAPPER(SSOCKOPT)
UNDEFINED_WRAPPER(ACCEPT)
UNDEFINED_WRAPPER(GSOCKOPT)
UNDEFINED_WRAPPER(SHUTDOWN)
UNDEFINED_WRAPPER(SOCKPAIR)

UNDEFINED_WRAPPER(READ)
UNDEFINED_WRAPPER(RECV)
UNDEFINED_WRAPPER(SYSREAD)
UNDEFINED_WRAPPER(SYSWRITE)

UNDEFINED_FILE_WRAPPER(LSTAT, TOPs)
UNDEFINED_FILE_WRAPPER(STAT, TOPs)
UNDEFINED_FILE_WRAPPER(CHDIR, TOPs)
NUMERIC_WRAPPER(CHOWN, 2)
UNDEFINED_FILE_WRAPPER(CHROOT, TOPs)
NUMERIC_WRAPPER(UNLINK, 0)
NUMERIC_WRAPPER(CHMOD, 1)
NUMERIC_WRAPPER(UTIME, 2)
UNDEFINED_WRAPPER(RENAME)
UNDEFINED_WRAPPER(LINK)
UNDEFINED_WRAPPER(SYMLINK)
UNDEFINED_FILE_WRAPPER(READLINK, TOPs)
UNDEFINED_FILE_WRAPPER(MKDIR, TOPs)
UNDEFINED_FILE_WRAPPER(RMDIR, TOPs)
UNDEFINED_FILE_WRAPPER(OPEN_DIR, TOPs)
UNDEFINED_WRAPPER(CLOSEDIR)
/* UNDEFINED_FILE_WRAPPER(DOFILE, TOPs) needs specialization */
UNDEFINED_FILE_WRAPPER(DBMOPEN, ST(1))
UNDEFINED_WRAPPER(DBMCLOSE)

UNDEFINED_WRAPPER(GHBYADDR)
UNDEFINED_WRAPPER(GNBYADDR)

UNDEFINED_WRAPPER(MSGCTL)
UNDEFINED_WRAPPER(MSGGET)
UNDEFINED_WRAPPER(MSGRCV)
UNDEFINED_WRAPPER(MSGSND)

UNDEFINED_WRAPPER(SEMCTL)
UNDEFINED_WRAPPER(SEMGET)
UNDEFINED_WRAPPER(SEMOP)

UNDEFINED_WRAPPER(SHMCTL)
UNDEFINED_WRAPPER(SHMGET)
UNDEFINED_WRAPPER(SHMREAD)

FILETEST_WRAPPER(FTRREAD)
FILETEST_WRAPPER(FTRWRITE)
FILETEST_WRAPPER(FTREXEC)
FILETEST_WRAPPER(FTEREAD)
FILETEST_WRAPPER(FTEWRITE)
FILETEST_WRAPPER(FTEEXEC)

FILETEST_WRAPPER(FTIS)
FILETEST_WRAPPER(FTSIZE)
FILETEST_WRAPPER(FTMTIME)
FILETEST_WRAPPER(FTCTIME)
FILETEST_WRAPPER(FTATIME)

FILETEST_WRAPPER(FTROWNED)
FILETEST_WRAPPER(FTEOWNED)
FILETEST_WRAPPER(FTZERO)
FILETEST_WRAPPER(FTSOCK)
FILETEST_WRAPPER(FTCHR)
FILETEST_WRAPPER(FTBLK)
FILETEST_WRAPPER(FTFILE)
FILETEST_WRAPPER(FTDIR)
FILETEST_WRAPPER(FTPIPE)
FILETEST_WRAPPER(FTSUID)
FILETEST_WRAPPER(FTSGID)
FILETEST_WRAPPER(FTSVTX)

FILETEST_WRAPPER(FTLINK)
FILETEST_WRAPPER(FTTTY)
FILETEST_WRAPPER(FTTEXT)
FILETEST_WRAPPER(FTBINARY)
