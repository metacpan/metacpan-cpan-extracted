
<{!-- normally these would be loaded from a directory or database
      using a <contents> tag. However for ease of demonstration,
      let's just list them here as inline <content> items.

      BTW, while we're here, note that any of the meta tags can use a
      format="text/whatever" attribute to allow them to be converted from a
      non-HTML format.  Not used here, but it can be handy, especially for
      Abstracts.

   --}>

<content name="story_1.txt" format="text/et">
<wmmeta name="Title" value="Story 1, blah blah" />
<wmmeta name="Score" value="20" />
<wmmeta name="Abstract"> Story 1, just another story.  </wmmeta>
<wmmeta name="Section" value="Business" />

This is story 1.

</content>

<content name="story_2.txt" format="text/et">
<wmmeta name="Title" value="Story 2, blah blah" />
<wmmeta name="Score" value="20" />
<wmmeta name="Abstract"> Story 2, just another story.  </wmmeta>
<wmmeta name="Section" value="Technology" />

This is story 2.

</content>

<content name="story_3.txt" format="text/et">
<wmmeta name="Title" value="Hot! story 3, etc etc." />
<wmmeta name="Score" value="10" />
<wmmeta name="Abstract"> Story 3, the highest-scored story.  </wmmeta>
<wmmeta name="Section" value="Technology" />
Breaking news! this is story 3.

</content>

<content name="story_4.txt" format="text/et">
<wmmeta name="Title" value="Story 4, blah blah" />
<wmmeta name="Score" value="20" />
<wmmeta name="Abstract"> Story 4, just another story.  </wmmeta>
<wmmeta name="Section" value="Business" />

This is story 4.

</content>

<content name="story_5.txt" format="text/et">
<wmmeta name="Title" value="Story 5, zzzzzzz" />
<wmmeta name="Score" value="999" />
<wmmeta name="Abstract"> Story 5, incredibly boring.  </wmmeta>
<wmmeta name="Section" value="Business" />

This is story 5. It's astoundingly boring, which is why it's down here.

</content>

<content name="story_6.txt" format="text/et">
<wmmeta name="Title" value="Story 6, blah blah" />
<wmmeta name="Score" value="20" />
<wmmeta name="Abstract"> Story 6, just another story.  </wmmeta>
<wmmeta name="Section" value="World" />

This is story 6.

</content>

<content name="story_7.txt" format="text/et">
<wmmeta name="Title" value="Story 7, blah blah" />
<wmmeta name="Score" value="20" />
<wmmeta name="Abstract"> Story 7, just another story.  </wmmeta>
<wmmeta name="Section" value="World" />

This is story 7.

</content>

<content name="story_8.txt" format="text/et">
<wmmeta name="Title" value="Story 8, blah blah" />
<wmmeta name="Score" value="20" />
<wmmeta name="Abstract"> Story 8, just another story.  </wmmeta>
<wmmeta name="Section" value="World" />

This is story 8.

</content>

<content name="story_9.txt" format="text/et">
<wmmeta name="Title" value="Story 9, blah blah" />
<wmmeta name="Score" value="20" />
<wmmeta name="Abstract"> Story 9, just another story.  </wmmeta>
<wmmeta name="Section" value="Technology" />

This is story 9.

</content>
