jit_type_t libjit_const_jit_type_void (void) { return jit_type_void; }
jit_type_t libjit_const_jit_type_sbyte (void) { return jit_type_sbyte; }
jit_type_t libjit_const_jit_type_ubyte (void) { return jit_type_ubyte; }
jit_type_t libjit_const_jit_type_short (void) { return jit_type_short; }
jit_type_t libjit_const_jit_type_ushort (void) { return jit_type_ushort; }
jit_type_t libjit_const_jit_type_int (void) { return jit_type_int; }
jit_type_t libjit_const_jit_type_uint (void) { return jit_type_uint; }
jit_type_t libjit_const_jit_type_nint (void) { return jit_type_nint; }
jit_type_t libjit_const_jit_type_nuint (void) { return jit_type_nuint; }
jit_type_t libjit_const_jit_type_long (void) { return jit_type_long; }
jit_type_t libjit_const_jit_type_ulong (void) { return jit_type_ulong; }
jit_type_t libjit_const_jit_type_float32 (void) { return jit_type_float32; }
jit_type_t libjit_const_jit_type_float64 (void) { return jit_type_float64; }
jit_type_t libjit_const_jit_type_nfloat (void) { return jit_type_nfloat; }
jit_type_t libjit_const_jit_type_void_ptr (void) { return jit_type_void_ptr; }
jit_type_t libjit_const_jit_type_sys_bool (void) { return jit_type_sys_bool; }
jit_type_t libjit_const_jit_type_sys_char (void) { return jit_type_sys_char; }
jit_type_t libjit_const_jit_type_sys_schar (void) { return jit_type_sys_schar; }
jit_type_t libjit_const_jit_type_sys_uchar (void) { return jit_type_sys_uchar; }
jit_type_t libjit_const_jit_type_sys_short (void) { return jit_type_sys_short; }
jit_type_t libjit_const_jit_type_sys_ushort (void) { return jit_type_sys_ushort; }
jit_type_t libjit_const_jit_type_sys_int (void) { return jit_type_sys_int; }
jit_type_t libjit_const_jit_type_sys_uint (void) { return jit_type_sys_uint; }
jit_type_t libjit_const_jit_type_sys_long (void) { return jit_type_sys_long; }
jit_type_t libjit_const_jit_type_sys_ulong (void) { return jit_type_sys_ulong; }
jit_type_t libjit_const_jit_type_sys_longlong (void) { return jit_type_sys_longlong; }
jit_type_t libjit_const_jit_type_sys_ulonglong (void) { return jit_type_sys_ulonglong; }
jit_type_t libjit_const_jit_type_sys_float (void) { return jit_type_sys_float; }
jit_type_t libjit_const_jit_type_sys_double (void) { return jit_type_sys_double; }
jit_type_t libjit_const_jit_type_sys_long_double (void) { return jit_type_sys_long_double; }
