#if LIBCURL_HAS(CURLOPT_PORT)
    case CURLOPT_PORT:
#endif
#if LIBCURL_HAS(CURLOPT_TIMEOUT)
    case CURLOPT_TIMEOUT:
#endif
#if LIBCURL_HAS(CURLOPT_INFILESIZE)
    case CURLOPT_INFILESIZE:
#endif
#if LIBCURL_HAS(CURLOPT_LOW_SPEED_LIMIT)
    case CURLOPT_LOW_SPEED_LIMIT:
#endif
#if LIBCURL_HAS(CURLOPT_LOW_SPEED_TIME)
    case CURLOPT_LOW_SPEED_TIME:
#endif
#if LIBCURL_HAS(CURLOPT_RESUME_FROM)
    case CURLOPT_RESUME_FROM:
#endif
#if LIBCURL_HAS(CURLOPT_CRLF)
    case CURLOPT_CRLF:
#endif
#if LIBCURL_HAS(CURLOPT_SSLVERSION)
    case CURLOPT_SSLVERSION:
#endif
#if LIBCURL_HAS(CURLOPT_TIMECONDITION)
    case CURLOPT_TIMECONDITION:
#endif
#if LIBCURL_HAS(CURLOPT_TIMEVALUE)
    case CURLOPT_TIMEVALUE:
#endif
#if LIBCURL_HAS(CURLOPT_VERBOSE)
    case CURLOPT_VERBOSE:
#endif
#if LIBCURL_HAS(CURLOPT_HEADER)
    case CURLOPT_HEADER:
#endif
#if LIBCURL_HAS(CURLOPT_NOPROGRESS)
    case CURLOPT_NOPROGRESS:
#endif
#if LIBCURL_HAS(CURLOPT_NOBODY)
    case CURLOPT_NOBODY:
#endif
#if LIBCURL_HAS(CURLOPT_FAILONERROR)
    case CURLOPT_FAILONERROR:
#endif
#if LIBCURL_HAS(CURLOPT_UPLOAD)
    case CURLOPT_UPLOAD:
#endif
#if LIBCURL_HAS(CURLOPT_POST)
    case CURLOPT_POST:
#endif
#if LIBCURL_HAS(CURLOPT_DIRLISTONLY)
    case CURLOPT_DIRLISTONLY:
#endif
#if LIBCURL_HAS(CURLOPT_APPEND)
    case CURLOPT_APPEND:
#endif
#if LIBCURL_HAS(CURLOPT_NETRC)
    case CURLOPT_NETRC:
#endif
#if LIBCURL_HAS(CURLOPT_FOLLOWLOCATION)
    case CURLOPT_FOLLOWLOCATION:
#endif
#if LIBCURL_HAS(CURLOPT_TRANSFERTEXT)
    case CURLOPT_TRANSFERTEXT:
#endif
#if LIBCURL_HAS(CURLOPT_PUT)
    case CURLOPT_PUT:
#endif
#if LIBCURL_HAS(CURLOPT_AUTOREFERER)
    case CURLOPT_AUTOREFERER:
#endif
#if LIBCURL_HAS(CURLOPT_PROXYPORT)
    case CURLOPT_PROXYPORT:
#endif
#if LIBCURL_HAS(CURLOPT_HTTPPROXYTUNNEL)
    case CURLOPT_HTTPPROXYTUNNEL:
#endif
#if LIBCURL_HAS(CURLOPT_SSL_VERIFYPEER)
    case CURLOPT_SSL_VERIFYPEER:
#endif
#if LIBCURL_HAS(CURLOPT_MAXREDIRS)
    case CURLOPT_MAXREDIRS:
#endif
#if LIBCURL_HAS(CURLOPT_FILETIME)
    case CURLOPT_FILETIME:
#endif
#if LIBCURL_HAS(CURLOPT_MAXCONNECTS)
    case CURLOPT_MAXCONNECTS:
#endif
#if LIBCURL_HAS(CURLOPT_OBSOLETE72)
    case CURLOPT_OBSOLETE72:
#endif
#if LIBCURL_HAS(CURLOPT_FRESH_CONNECT)
    case CURLOPT_FRESH_CONNECT:
#endif
#if LIBCURL_HAS(CURLOPT_FORBID_REUSE)
    case CURLOPT_FORBID_REUSE:
#endif
#if LIBCURL_HAS(CURLOPT_CONNECTTIMEOUT)
    case CURLOPT_CONNECTTIMEOUT:
#endif
#if LIBCURL_HAS(CURLOPT_HTTPGET)
    case CURLOPT_HTTPGET:
#endif
#if LIBCURL_HAS(CURLOPT_SSL_VERIFYHOST)
    case CURLOPT_SSL_VERIFYHOST:
#endif
#if LIBCURL_HAS(CURLOPT_HTTP_VERSION)
    case CURLOPT_HTTP_VERSION:
#endif
#if LIBCURL_HAS(CURLOPT_FTP_USE_EPSV)
    case CURLOPT_FTP_USE_EPSV:
#endif
#if LIBCURL_HAS(CURLOPT_SSLENGINE_DEFAULT)
    case CURLOPT_SSLENGINE_DEFAULT:
#endif
#if LIBCURL_HAS(CURLOPT_DNS_USE_GLOBAL_CACHE)
    case CURLOPT_DNS_USE_GLOBAL_CACHE:
#endif
#if LIBCURL_HAS(CURLOPT_DNS_CACHE_TIMEOUT)
    case CURLOPT_DNS_CACHE_TIMEOUT:
#endif
#if LIBCURL_HAS(CURLOPT_COOKIESESSION)
    case CURLOPT_COOKIESESSION:
#endif
#if LIBCURL_HAS(CURLOPT_BUFFERSIZE)
    case CURLOPT_BUFFERSIZE:
#endif
#if LIBCURL_HAS(CURLOPT_NOSIGNAL)
    case CURLOPT_NOSIGNAL:
#endif
#if LIBCURL_HAS(CURLOPT_PROXYTYPE)
    case CURLOPT_PROXYTYPE:
#endif
#if LIBCURL_HAS(CURLOPT_UNRESTRICTED_AUTH)
    case CURLOPT_UNRESTRICTED_AUTH:
#endif
#if LIBCURL_HAS(CURLOPT_FTP_USE_EPRT)
    case CURLOPT_FTP_USE_EPRT:
#endif
#if LIBCURL_HAS(CURLOPT_HTTPAUTH)
    case CURLOPT_HTTPAUTH:
#endif
#if LIBCURL_HAS(CURLOPT_FTP_CREATE_MISSING_DIRS)
    case CURLOPT_FTP_CREATE_MISSING_DIRS:
#endif
#if LIBCURL_HAS(CURLOPT_PROXYAUTH)
    case CURLOPT_PROXYAUTH:
#endif
#if LIBCURL_HAS(CURLOPT_FTP_RESPONSE_TIMEOUT)
    case CURLOPT_FTP_RESPONSE_TIMEOUT:
#endif
#if LIBCURL_HAS(CURLOPT_IPRESOLVE)
    case CURLOPT_IPRESOLVE:
#endif
#if LIBCURL_HAS(CURLOPT_MAXFILESIZE)
    case CURLOPT_MAXFILESIZE:
#endif
#if LIBCURL_HAS(CURLOPT_USE_SSL)
    case CURLOPT_USE_SSL:
#endif
#if LIBCURL_HAS(CURLOPT_TCP_NODELAY)
    case CURLOPT_TCP_NODELAY:
#endif
#if LIBCURL_HAS(CURLOPT_FTPSSLAUTH)
    case CURLOPT_FTPSSLAUTH:
#endif
#if LIBCURL_HAS(CURLOPT_IGNORE_CONTENT_LENGTH)
    case CURLOPT_IGNORE_CONTENT_LENGTH:
#endif
#if LIBCURL_HAS(CURLOPT_FTP_SKIP_PASV_IP)
    case CURLOPT_FTP_SKIP_PASV_IP:
#endif
#if LIBCURL_HAS(CURLOPT_FTP_FILEMETHOD)
    case CURLOPT_FTP_FILEMETHOD:
#endif
#if LIBCURL_HAS(CURLOPT_LOCALPORT)
    case CURLOPT_LOCALPORT:
#endif
#if LIBCURL_HAS(CURLOPT_LOCALPORTRANGE)
    case CURLOPT_LOCALPORTRANGE:
#endif
#if LIBCURL_HAS(CURLOPT_CONNECT_ONLY)
    case CURLOPT_CONNECT_ONLY:
#endif
#if LIBCURL_HAS(CURLOPT_SSL_SESSIONID_CACHE)
    case CURLOPT_SSL_SESSIONID_CACHE:
#endif
#if LIBCURL_HAS(CURLOPT_SSH_AUTH_TYPES)
    case CURLOPT_SSH_AUTH_TYPES:
#endif
#if LIBCURL_HAS(CURLOPT_FTP_SSL_CCC)
    case CURLOPT_FTP_SSL_CCC:
#endif
#if LIBCURL_HAS(CURLOPT_TIMEOUT_MS)
    case CURLOPT_TIMEOUT_MS:
#endif
#if LIBCURL_HAS(CURLOPT_CONNECTTIMEOUT_MS)
    case CURLOPT_CONNECTTIMEOUT_MS:
#endif
#if LIBCURL_HAS(CURLOPT_HTTP_TRANSFER_DECODING)
    case CURLOPT_HTTP_TRANSFER_DECODING:
#endif
#if LIBCURL_HAS(CURLOPT_HTTP_CONTENT_DECODING)
    case CURLOPT_HTTP_CONTENT_DECODING:
#endif
#if LIBCURL_HAS(CURLOPT_NEW_FILE_PERMS)
    case CURLOPT_NEW_FILE_PERMS:
#endif
#if LIBCURL_HAS(CURLOPT_NEW_DIRECTORY_PERMS)
    case CURLOPT_NEW_DIRECTORY_PERMS:
#endif
#if LIBCURL_HAS(CURLOPT_POSTREDIR)
    case CURLOPT_POSTREDIR:
#endif
#if LIBCURL_HAS(CURLOPT_PROXY_TRANSFER_MODE)
    case CURLOPT_PROXY_TRANSFER_MODE:
#endif
#if LIBCURL_HAS(CURLOPT_ADDRESS_SCOPE)
    case CURLOPT_ADDRESS_SCOPE:
#endif
#if LIBCURL_HAS(CURLOPT_CERTINFO)
    case CURLOPT_CERTINFO:
#endif
#if LIBCURL_HAS(CURLOPT_TFTP_BLKSIZE)
    case CURLOPT_TFTP_BLKSIZE:
#endif
#if LIBCURL_HAS(CURLOPT_SOCKS5_GSSAPI_NEC)
    case CURLOPT_SOCKS5_GSSAPI_NEC:
#endif
#if LIBCURL_HAS(CURLOPT_PROTOCOLS)
    case CURLOPT_PROTOCOLS:
#endif
#if LIBCURL_HAS(CURLOPT_REDIR_PROTOCOLS)
    case CURLOPT_REDIR_PROTOCOLS:
#endif
#if LIBCURL_HAS(CURLOPT_FTP_USE_PRET)
    case CURLOPT_FTP_USE_PRET:
#endif
#if LIBCURL_HAS(CURLOPT_RTSP_REQUEST)
    case CURLOPT_RTSP_REQUEST:
#endif
#if LIBCURL_HAS(CURLOPT_RTSP_CLIENT_CSEQ)
    case CURLOPT_RTSP_CLIENT_CSEQ:
#endif
#if LIBCURL_HAS(CURLOPT_RTSP_SERVER_CSEQ)
    case CURLOPT_RTSP_SERVER_CSEQ:
#endif
#if LIBCURL_HAS(CURLOPT_WILDCARDMATCH)
    case CURLOPT_WILDCARDMATCH:
#endif
#if LIBCURL_HAS(CURLOPT_TRANSFER_ENCODING)
    case CURLOPT_TRANSFER_ENCODING:
#endif
#if LIBCURL_HAS(CURLOPT_GSSAPI_DELEGATION)
    case CURLOPT_GSSAPI_DELEGATION:
#endif
#if LIBCURL_HAS(CURLOPT_ACCEPTTIMEOUT_MS)
    case CURLOPT_ACCEPTTIMEOUT_MS:
#endif
#if LIBCURL_HAS(CURLOPT_TCP_KEEPALIVE)
    case CURLOPT_TCP_KEEPALIVE:
#endif
#if LIBCURL_HAS(CURLOPT_TCP_KEEPIDLE)
    case CURLOPT_TCP_KEEPIDLE:
#endif
#if LIBCURL_HAS(CURLOPT_TCP_KEEPINTVL)
    case CURLOPT_TCP_KEEPINTVL:
#endif
#if LIBCURL_HAS(CURLOPT_SSL_OPTIONS)
    case CURLOPT_SSL_OPTIONS:
#endif
#if LIBCURL_HAS(CURLOPT_SASL_IR)
    case CURLOPT_SASL_IR:
#endif
#if LIBCURL_HAS(CURLOPT_SSL_ENABLE_NPN)
    case CURLOPT_SSL_ENABLE_NPN:
#endif
#if LIBCURL_HAS(CURLOPT_SSL_ENABLE_ALPN)
    case CURLOPT_SSL_ENABLE_ALPN:
#endif
#if LIBCURL_HAS(CURLOPT_EXPECT_100_TIMEOUT_MS)
    case CURLOPT_EXPECT_100_TIMEOUT_MS:
#endif
#if LIBCURL_HAS(CURLOPT_HEADEROPT)
    case CURLOPT_HEADEROPT:
#endif
#if LIBCURL_HAS(CURLOPT_SSL_VERIFYSTATUS)
    case CURLOPT_SSL_VERIFYSTATUS:
#endif
#if LIBCURL_HAS(CURLOPT_SSL_FALSESTART)
    case CURLOPT_SSL_FALSESTART:
#endif
#if LIBCURL_HAS(CURLOPT_PATH_AS_IS)
    case CURLOPT_PATH_AS_IS:
#endif
#if LIBCURL_HAS(CURLOPT_PIPEWAIT)
    case CURLOPT_PIPEWAIT:
#endif
#if LIBCURL_HAS(CURLOPT_STREAM_WEIGHT)
    case CURLOPT_STREAM_WEIGHT:
#endif
#if LIBCURL_HAS(CURLOPT_TFTP_NO_OPTIONS)
    case CURLOPT_TFTP_NO_OPTIONS:
#endif
#if LIBCURL_HAS(CURLOPT_TCP_FASTOPEN)
    case CURLOPT_TCP_FASTOPEN:
#endif
#if LIBCURL_HAS(CURLOPT_KEEP_SENDING_ON_ERROR)
    case CURLOPT_KEEP_SENDING_ON_ERROR:
#endif
#if LIBCURL_HAS(CURLOPT_PROXY_SSL_VERIFYPEER)
    case CURLOPT_PROXY_SSL_VERIFYPEER:
#endif
#if LIBCURL_HAS(CURLOPT_PROXY_SSL_VERIFYHOST)
    case CURLOPT_PROXY_SSL_VERIFYHOST:
#endif
#if LIBCURL_HAS(CURLOPT_PROXY_SSLVERSION)
    case CURLOPT_PROXY_SSLVERSION:
#endif
#if LIBCURL_HAS(CURLOPT_PROXY_SSL_OPTIONS)
    case CURLOPT_PROXY_SSL_OPTIONS:
#endif
#if LIBCURL_HAS(CURLOPT_SUPPRESS_CONNECT_HEADERS)
    case CURLOPT_SUPPRESS_CONNECT_HEADERS:
#endif
#if LIBCURL_HAS(CURLOPT_SOCKS5_AUTH)
    case CURLOPT_SOCKS5_AUTH:
#endif
#if LIBCURL_HAS(CURLOPT_SSH_COMPRESSION)
    case CURLOPT_SSH_COMPRESSION:
#endif
#if LIBCURL_HAS(CURLOPT_HAPPY_EYEBALLS_TIMEOUT_MS)
    case CURLOPT_HAPPY_EYEBALLS_TIMEOUT_MS:
#endif
#if LIBCURL_HAS(CURLOPT_HAPROXYPROTOCOL)
    case CURLOPT_HAPROXYPROTOCOL:
#endif
#if LIBCURL_HAS(CURLOPT_DNS_SHUFFLE_ADDRESSES)
    case CURLOPT_DNS_SHUFFLE_ADDRESSES:
#endif
#if LIBCURL_HAS(CURLOPT_DISALLOW_USERNAME_IN_URL)
    case CURLOPT_DISALLOW_USERNAME_IN_URL:
#endif
#if LIBCURL_HAS(CURLOPT_UPLOAD_BUFFERSIZE)
    case CURLOPT_UPLOAD_BUFFERSIZE:
#endif
#if LIBCURL_HAS(CURLOPT_UPKEEP_INTERVAL_MS)
    case CURLOPT_UPKEEP_INTERVAL_MS:
#endif
#if LIBCURL_HAS(CURLOPT_HTTP09_ALLOWED)
    case CURLOPT_HTTP09_ALLOWED:
#endif
#if LIBCURL_HAS(CURLOPT_ALTSVC_CTRL)
    case CURLOPT_ALTSVC_CTRL:
#endif
#if LIBCURL_HAS(CURLOPT_MAXAGE_CONN)
    case CURLOPT_MAXAGE_CONN:
#endif
#if LIBCURL_HAS(CURLOPT_MAIL_RCPT_ALLLOWFAILS)
    case CURLOPT_MAIL_RCPT_ALLLOWFAILS:
#endif
#if LIBCURL_HAS(CURLOPT_HSTS_CTRL)
    case CURLOPT_HSTS_CTRL:
#endif
