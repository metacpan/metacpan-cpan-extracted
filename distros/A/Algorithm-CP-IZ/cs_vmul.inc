void*
cs_VMul3(vint1, vint2, vint3)
    void* vint1
    void* vint2
    void* vint3
CODE:
    RETVAL = cs_VMul(3, vint1, vint2, vint3);
OUTPUT:
    RETVAL

void*
cs_VMul4(vint1, vint2, vint3, vint4)
    void* vint1
    void* vint2
    void* vint3
    void* vint4
CODE:
    RETVAL = cs_VMul(4, vint1, vint2, vint3, vint4);
OUTPUT:
    RETVAL

void*
cs_VMul5(vint1, vint2, vint3, vint4, vint5)
    void* vint1
    void* vint2
    void* vint3
    void* vint4
    void* vint5
CODE:
    RETVAL = cs_VMul(5, vint1, vint2, vint3, vint4, vint5);
OUTPUT:
    RETVAL

void*
cs_VMul6(vint1, vint2, vint3, vint4, vint5, vint6)
    void* vint1
    void* vint2
    void* vint3
    void* vint4
    void* vint5
    void* vint6
CODE:
    RETVAL = cs_VMul(6, vint1, vint2, vint3, vint4, vint5, vint6);
OUTPUT:
    RETVAL

void*
cs_VMul7(vint1, vint2, vint3, vint4, vint5, vint6, vint7)
    void* vint1
    void* vint2
    void* vint3
    void* vint4
    void* vint5
    void* vint6
    void* vint7
CODE:
    RETVAL = cs_VMul(7, vint1, vint2, vint3, vint4, vint5, vint6, vint7);
OUTPUT:
    RETVAL

void*
cs_VMul8(vint1, vint2, vint3, vint4, vint5, vint6, vint7, vint8)
    void* vint1
    void* vint2
    void* vint3
    void* vint4
    void* vint5
    void* vint6
    void* vint7
    void* vint8
CODE:
    RETVAL = cs_VMul(8, vint1, vint2, vint3, vint4, vint5, vint6, vint7, vint8);
OUTPUT:
    RETVAL

void*
cs_VMul9(vint1, vint2, vint3, vint4, vint5, vint6, vint7, vint8, vint9)
    void* vint1
    void* vint2
    void* vint3
    void* vint4
    void* vint5
    void* vint6
    void* vint7
    void* vint8
    void* vint9
CODE:
    RETVAL = cs_VMul(9, vint1, vint2, vint3, vint4, vint5, vint6, vint7, vint8, vint9);
OUTPUT:
    RETVAL

void*
cs_VMul10(vint1, vint2, vint3, vint4, vint5, vint6, vint7, vint8, vint9, vint10)
    void* vint1
    void* vint2
    void* vint3
    void* vint4
    void* vint5
    void* vint6
    void* vint7
    void* vint8
    void* vint9
    void* vint10
CODE:
    RETVAL = cs_VMul(10, vint1, vint2, vint3, vint4, vint5, vint6, vint7, vint8, vint9, vint10);
OUTPUT:
    RETVAL

