
#ifndef PORTABLE_C__
#define PORTABLE_C__

#include <limits.h>
#include <stdio.h>
#include <stdlib.h>
#include <string.h>

/* Definition of minimum-width integer types
 * 
 * u8   -> unsigned integer type, at least 8 bits, equivalent to unsigned char
 * u16  -> unsigned integer type, at least 16 bits
 * u32  -> unsigned integer type, at least 32 bits
 *
 * s8, s16, s32  -> signed counterparts of u8, u16, u32
 *
 * Always use macro's T8(), T16() or T32() to obtain exact-width results,
 * i.e., to specify the size of the result of each expression.
 */

typedef signed char s8;
typedef unsigned char u8;

#if UINT_MAX >= 4294967295UL

typedef signed short s16;
typedef signed int s32;
typedef unsigned short u16;
typedef unsigned int u32;

#define ONE32   0xffffffffU

#else

typedef signed int s16;
typedef signed long s32;
typedef unsigned int u16;
typedef unsigned long u32;

#define ONE32   0xffffffffUL

#endif

#define ONE8    0xffU
#define ONE16   0xffffU

#define T8(x)   ((x) & ONE8)
#define T16(x)  ((x) & ONE16)
#define T32(x)  ((x) & ONE32)

/*
 * If you want 64-bit values, uncomment the following lines; this
 * reduces portability.
 */
#if ((1UL << 31) * 2UL) != 0UL
#ifdef _MSC_VER
typedef unsigned __int64 u64;
typedef signed __int64 s64;
#else  /* !_MSC_VER */
typedef unsigned long u64;
typedef signed long s64;
#define ONE64   0xffffffffffffffffUL
#endif /* ?_MSC_VER */
#else
#ifdef _MSC_VER
typedef unsigned __int64 u64;
typedef signed __int64 s64;
#else  /* !_MSC_VER */
typedef unsigned long long u64;
typedef signed long long s64;
#define ONE64   0xffffffffffffffffULL
#endif /* ?_MSC_VER */
#endif
#define T64(x)  ((x) & ONE64)
/*
 * Note: the test is used to detect native 64-bit architectures;
 * if the unsigned long is strictly greater than 32-bit, it is
 * assumed to be at least 64-bit. This will not work correctly
 * on (old) 36-bit architectures (PDP-11 for instance).
 *
 * On non-64-bit architectures, "long long" is used.
 */

/*
 * U8TO32_BIG(c) returns the 32-bit value stored in big-endian convention
 * in the unsigned char array pointed to by c.
 */
#define U8TO32_BIG(c)  (((u32)T8(*(c)) << 24) | ((u32)T8(*((c) + 1)) << 16) \
                       ((u32)T8(*((c) + 2)) << 8) | ((u32)T8(*((c) + 3))))

/*
 * U8TO32_LITTLE(c) returns the 32-bit value stored in little-endian convention
 * in the unsigned char array pointed to by c.
 */
#define U8TO32_LITTLE(c)  (((u32)T8(*(c))) | ((u32)T8(*((c) + 1)) << 8) \
                      (u32)T8(*((c) + 2)) << 16) | ((u32)T8(*((c) + 3)) << 24))

/*
 * U8TO32_BIG(c, v) stores the 32-bit-value v in big-endian convention
 * into the unsigned char array pointed to by c.
 */
#define U32TO8_BIG(c, v)    do { \
		u32 x = (v); \
		u8 *d = (c); \
		d[0] = T8(x >> 24); \
		d[1] = T8(x >> 16); \
		d[2] = T8(x >> 8); \
		d[3] = T8(x); \
	} while (0)

/*
 * U8TO32_LITTLE(c, v) stores the 32-bit-value v in little-endian convention
 * into the unsigned char array pointed to by c.
 */
#define U32TO8_LITTLE(c, v)    do { \
		u32 x = (v); \
		u8 *d = (c); \
		d[0] = T8(x); \
		d[1] = T8(x >> 8); \
		d[2] = T8(x >> 16); \
		d[3] = T8(x >> 24); \
	} while (0)

/*
 * ROTL32(v, n) returns the value of the 32-bit unsigned value v after
 * a rotation of n bits to the left. It might be replaced by the appropriate
 * architecture-specific macro.
 *
 * It evaluates v and n twice.
 *
 * The compiler might emit a warning if n is the constant 0. The result
 * is undefined if n is greater than 31.
 */
#define ROTL32(v, n)   (T32((v) << (n)) | ((v) >> (32 - (n))))

/*
 *  Khazad-specific definitions
 */
#define R			8
#define KEYSIZE		128
#define KEYSIZEB	(KEYSIZE/8)
#define BLOCKSIZE	64
#define BLOCKSIZEB	(BLOCKSIZE/8)

typedef struct NESSIEstruct {
	u32 roundKeyEnc[R + 1][2];
	u32 roundKeyDec[R + 1][2];
} NESSIEstruct;

/**
 * Create the Khazad key schedule for a given cipher key.
 * Both encryption and decryption key schedules are generated.
 * 
 * @param key			The 128-bit cipher key.
 * @param structpointer	Pointer to the structure that will hold the expanded key.
 */
void NESSIEkeysetup(const unsigned char * const key,
				struct NESSIEstruct * const structpointer);

/**
 * Encrypt a data block.
 * 
 * @param	structpointer	the expanded key.
 * @param	plaintext		the data block to be encrypted.
 * @param	ciphertext		the encrypted data block.
 */
void NESSIEencrypt(const struct NESSIEstruct * const structpointer,
				   const unsigned char * const plaintext,
				         unsigned char * const ciphertext);

/**
 * Decrypt a data block.
 * 
 * @param	structpointer	the expanded key.
 * @param	ciphertext		the data block to be decrypted.
 * @param	plaintext		the decrypted data block.
 */
void NESSIEdecrypt(const struct NESSIEstruct * const structpointer,
				   const unsigned char * const ciphertext,
				         unsigned char * const plaintext);


#endif   /* PORTABLE_C__ */

/**
 * The Khazad legacy-level block cipher (32-bit implementation).
 *
 * <P>
 * <b>References</b>
 *
 * <P>
 * The Khazad algorithm was developed by
 * <a href="mailto:pbarreto@scopus.com.br">Paulo S. L. M. Barreto</a> and
 * <a href="mailto:vincent.rijmen@cryptomathic.com">Vincent Rijmen</a>.
 *
 * See
 *		P.S.L.M. Barreto, V. Rijmen,
 *		``The Khazad legacy-level block cipher,''
 *		NESSIE submission, 2000.
 * 
 * @author	Paulo S.L.M. Barreto
 * @author	Vincent Rijmen.
 *
 * @version 2.0 (2001.09.24)
 * 
 * =============================================================================
 *
 * Differences from version 1.0:
 *
 * - Original S-box replaced by the tweaked, hardware-efficient version.
 *
 * =============================================================================
 *
 * THIS SOFTWARE IS PROVIDED BY THE AUTHORS ''AS IS'' AND ANY EXPRESS
 * OR IMPLIED WARRANTIES, INCLUDING, BUT NOT LIMITED TO, THE IMPLIED
 * WARRANTIES OF MERCHANTABILITY AND FITNESS FOR A PARTICULAR PURPOSE
 * ARE DISCLAIMED.  IN NO EVENT SHALL THE AUTHORS OR CONTRIBUTORS BE
 * LIABLE FOR ANY DIRECT, INDIRECT, INCIDENTAL, SPECIAL, EXEMPLARY, OR
 * CONSEQUENTIAL DAMAGES (INCLUDING, BUT NOT LIMITED TO, PROCUREMENT OF
 * SUBSTITUTE GOODS OR SERVICES; LOSS OF USE, DATA, OR PROFITS; OR
 * BUSINESS INTERRUPTION) HOWEVER CAUSED AND ON ANY THEORY OF LIABILITY,
 * WHETHER IN CONTRACT, STRICT LIABILITY, OR TORT (INCLUDING NEGLIGENCE
 * OR OTHERWISE) ARISING IN ANY WAY OUT OF THE USE OF THIS SOFTWARE,
 * EVEN IF ADVISED OF THE POSSIBILITY OF SUCH DAMAGE.
 *
 */

/*
 * Though Khazad is endianness-neutral, the encryption tables are listed
 * in BIG-ENDIAN format, which is adopted throughout this implementation
 * (but little-endian notation would be equally suitable if consistently
 * employed).
 */

static const u32 U0[256] = {
    0xbad3d268UL, 0x54fc4d19UL, 0x2f71bc93UL, 0x749ccdb9UL,
    0x53f55102UL, 0xd3686bb8UL, 0xd26b6fbdUL, 0x4dd72964UL,
    0x50f05d0dUL, 0xace98a26UL, 0x8d8a0e83UL, 0xbfdcc679UL,
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    0x1f217c63UL, 0xca430fc5UL, 0xaae39238UL, 0x42c61557UL,
};

static const u32 V0[256] = {
    0xbbb96a01UL, 0xe59a66b1UL, 0xe26514cdUL, 0x25871b51UL,
    0xf7a257a4UL, 0xd0d6be03UL, 0xd6deb504UL, 0xb35285feUL,
    0xfdba4aadUL, 0xcf09e063UL, 0x091c9684UL, 0xa5914d1aUL,
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    0x42f8d95dUL, 0x861e5d4cUL, 0xdb39da71UL, 0x912aecd3UL,
};

static const u32 U1[256] = {
    0xd3ba68d2UL, 0xfc54194dUL, 0x712f93bcUL, 0x9c74b9cdUL,
    0xf5530251UL, 0x68d3b86bUL, 0x6bd2bd6fUL, 0xd74d6429UL,
    0xf0500d5dUL, 0xe9ac268aUL, 0x8a8d830eUL, 0xdcbf79c6UL,
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    0x211f637cUL, 0x43cac50fUL, 0xe3aa3892UL, 0xc6425715UL,
};

static const u32 V1[256] = {
    0xb9bb016aUL, 0x9ae5b166UL, 0x65e2cd14UL, 0x8725511bUL,
    0xa2f7a457UL, 0xd6d003beUL, 0xded604b5UL, 0x52b3fe85UL,
    0xbafdad4aUL, 0x09cf63e0UL, 0x1c098496UL, 0x91a51a4dUL,
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    0xf8425dd9UL, 0x1e864c5dUL, 0x39db71daUL, 0x2a91d3ecUL,
};

static const u32 U2[256] = {
    0xd268bad3UL, 0x4d1954fcUL, 0xbc932f71UL, 0xcdb9749cUL,
    0x510253f5UL, 0x6bb8d368UL, 0x6fbdd26bUL, 0x29644dd7UL,
    0x5d0d50f0UL, 0x8a26ace9UL, 0x0e838d8aUL, 0xc679bfdcUL,
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    0x7c631f21UL, 0x0fc5ca43UL, 0x9238aae3UL, 0x155742c6UL,
};

static const u32 V2[256] = {
    0x6a01bbb9UL, 0x66b1e59aUL, 0x14cde265UL, 0x1b512587UL,
    0x57a4f7a2UL, 0xbe03d0d6UL, 0xb504d6deUL, 0x85feb352UL,
    0x4aadfdbaUL, 0xe063cf09UL, 0x9684091cUL, 0x4d1aa591UL,
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    0xd95d42f8UL, 0x5d4c861eUL, 0xda71db39UL, 0xecd3912aUL,
};

static const u32 U3[256] = {
    0x68d2d3baUL, 0x194dfc54UL, 0x93bc712fUL, 0xb9cd9c74UL,
    0x0251f553UL, 0xb86b68d3UL, 0xbd6f6bd2UL, 0x6429d74dUL,
    0x0d5df050UL, 0x268ae9acUL, 0x830e8a8dUL, 0x79c6dcbfUL,
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    0x637c211fUL, 0xc50f43caUL, 0x3892e3aaUL, 0x5715c642UL,
};

static const u32 V3[256] = {
    0x016ab9bbUL, 0xb1669ae5UL, 0xcd1465e2UL, 0x511b8725UL,
    0xa457a2f7UL, 0x03bed6d0UL, 0x04b5ded6UL, 0xfe8552b3UL,
    0xad4abafdUL, 0x63e009cfUL, 0x84961c09UL, 0x1a4d91a5UL,
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    0x5dd9f842UL, 0x4c5d1e86UL, 0x71da39dbUL, 0xd3ec2a91UL,
};

static const u32 U4[256] = {
    0xbbb96a01UL, 0xe59a66b1UL, 0xe26514cdUL, 0x25871b51UL,
    0xf7a257a4UL, 0xd0d6be03UL, 0xd6deb504UL, 0xb35285feUL,
    0xfdba4aadUL, 0xcf09e063UL, 0x091c9684UL, 0xa5914d1aUL,
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    0x42f8d95dUL, 0x861e5d4cUL, 0xdb39da71UL, 0x912aecd3UL,
};

static const u32 V4[256] = {
    0xbad3d268UL, 0x54fc4d19UL, 0x2f71bc93UL, 0x749ccdb9UL,
    0x53f55102UL, 0xd3686bb8UL, 0xd26b6fbdUL, 0x4dd72964UL,
    0x50f05d0dUL, 0xace98a26UL, 0x8d8a0e83UL, 0xbfdcc679UL,
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    0x1f217c63UL, 0xca430fc5UL, 0xaae39238UL, 0x42c61557UL,
};

static const u32 U5[256] = {
    0xb9bb016aUL, 0x9ae5b166UL, 0x65e2cd14UL, 0x8725511bUL,
    0xa2f7a457UL, 0xd6d003beUL, 0xded604b5UL, 0x52b3fe85UL,
    0xbafdad4aUL, 0x09cf63e0UL, 0x1c098496UL, 0x91a51a4dUL,
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    0xf8425dd9UL, 0x1e864c5dUL, 0x39db71daUL, 0x2a91d3ecUL,
};

static const u32 V5[256] = {
    0xd3ba68d2UL, 0xfc54194dUL, 0x712f93bcUL, 0x9c74b9cdUL,
    0xf5530251UL, 0x68d3b86bUL, 0x6bd2bd6fUL, 0xd74d6429UL,
    0xf0500d5dUL, 0xe9ac268aUL, 0x8a8d830eUL, 0xdcbf79c6UL,
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    0x211f637cUL, 0x43cac50fUL, 0xe3aa3892UL, 0xc6425715UL,
};

static const u32 U6[256] = {
    0x6a01bbb9UL, 0x66b1e59aUL, 0x14cde265UL, 0x1b512587UL,
    0x57a4f7a2UL, 0xbe03d0d6UL, 0xb504d6deUL, 0x85feb352UL,
    0x4aadfdbaUL, 0xe063cf09UL, 0x9684091cUL, 0x4d1aa591UL,
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    0xd95d42f8UL, 0x5d4c861eUL, 0xda71db39UL, 0xecd3912aUL,
};

static const u32 V6[256] = {
    0xd268bad3UL, 0x4d1954fcUL, 0xbc932f71UL, 0xcdb9749cUL,
    0x510253f5UL, 0x6bb8d368UL, 0x6fbdd26bUL, 0x29644dd7UL,
    0x5d0d50f0UL, 0x8a26ace9UL, 0x0e838d8aUL, 0xc679bfdcUL,
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    0x7c631f21UL, 0x0fc5ca43UL, 0x9238aae3UL, 0x155742c6UL,
};

static const u32 U7[256] = {
    0x016ab9bbUL, 0xb1669ae5UL, 0xcd1465e2UL, 0x511b8725UL,
    0xa457a2f7UL, 0x03bed6d0UL, 0x04b5ded6UL, 0xfe8552b3UL,
    0xad4abafdUL, 0x63e009cfUL, 0x84961c09UL, 0x1a4d91a5UL,
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    0x5dd9f842UL, 0x4c5d1e86UL, 0x71da39dbUL, 0xd3ec2a91UL,
};

static const u32 V7[256] = {
    0x68d2d3baUL, 0x194dfc54UL, 0x93bc712fUL, 0xb9cd9c74UL,
    0x0251f553UL, 0xb86b68d3UL, 0xbd6f6bd2UL, 0x6429d74dUL,
    0x0d5df050UL, 0x268ae9acUL, 0x830e8a8dUL, 0x79c6dcbfUL,
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    0x637c211fUL, 0xc50f43caUL, 0x3892e3aaUL, 0x5715c642UL,
};

static const u32 c[R + 1][2] = {
    {0xba542f74UL, 0x53d3d24dUL},
    {0x50ac8dbfUL, 0x70529a4cUL},
    {0xead597d1UL, 0x33515ba6UL},
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    {0xf726ffedUL, 0xe89d6f8eUL},
};

/*
Definition of the 32-bit $U$ and $V$ matrices:

\begin{eqnarray*}
H & = & \left[\begin{array}{cc}
U & V \\
V & U
\end{array}\right], \\
U & = & \left[\begin{array}{cccc}
\gf{01} & \gf{03} & \gf{04} & \gf{05} \\
\gf{03} & \gf{01} & \gf{05} & \gf{04} \\
\gf{04} & \gf{05} & \gf{01} & \gf{03} \\
\gf{05} & \gf{04} & \gf{03} & \gf{01}
\end{array}\right], \\
V & = & \left[\begin{array}{cccc}
\gf{06} & \gf{08} & \gf{0b} & \gf{07} \\
\gf{08} & \gf{06} & \gf{07} & \gf{0b} \\
\gf{0b} & \gf{07} & \gf{06} & \gf{08} \\
\gf{07} & \gf{0b} & \gf{08} & \gf{06}
\end{array}\right].
\end{eqnarray*}

Definition of the corresponding $U$ and $V$ tables:

\begin{eqnarray*}
U_0[x] & = & S[x] \cdot \left[\begin{array}{cccc} \gf{01} & \gf{03} & \gf{04} & \gf{05} \end{array}\right],\\%
U_1[x] & = & S[x] \cdot \left[\begin{array}{cccc} \gf{03} & \gf{01} & \gf{05} & \gf{04} \end{array}\right],\\%
U_2[x] & = & S[x] \cdot \left[\begin{array}{cccc} \gf{04} & \gf{05} & \gf{01} & \gf{03} \end{array}\right],\\%
U_3[x] & = & S[x] \cdot \left[\begin{array}{cccc} \gf{05} & \gf{04} & \gf{03} & \gf{01} \end{array}\right];\\%
V_0[x] & = & S[x] \cdot \left[\begin{array}{cccc} \gf{06} & \gf{08} & \gf{0b} & \gf{07} \end{array}\right],\\%
V_1[x] & = & S[x] \cdot \left[\begin{array}{cccc} \gf{08} & \gf{06} & \gf{07} & \gf{0b} \end{array}\right],\\%
V_2[x] & = & S[x] \cdot \left[\begin{array}{cccc} \gf{0b} & \gf{07} & \gf{06} & \gf{08} \end{array}\right],\\%
V_3[x] & = & S[x] \cdot \left[\begin{array}{cccc} \gf{07} & \gf{0b} & \gf{08} & \gf{06} \end{array}\right];  %
\end{eqnarray*}

In terms of $T_i$:
\begin{eqnarray*}
U_i[x] & = & T_i[x] \rrr 32,\\%
V_i[x] & = & T_i[x] \& \mathtt{0xffffffff};  %
\end{eqnarray*}

*/

/**
 * Create the Khazad key schedule for a given cipher key.
 * Both encryption and decryption key schedules are generated.
 * 
 * @param key			The 128-bit cipher key.
 * @param structpointer	Pointer to the structure that will hold the expanded key.
 */
void NESSIEkeysetup(const unsigned char * const key,
				struct NESSIEstruct * const structpointer)
{
	int r;
	const u32 *S = U3;

    /*
	 * map u8 array cipher key to initial key state (mu):
	 */
	u32 K20 =
		((u32)key[ 0] << 24) ^
		((u32)key[ 1] << 16) ^
		((u32)key[ 2] <<  8) ^
		((u32)key[ 3]      );
	u32 K21 =
		((u32)key[ 4] << 24) ^
		((u32)key[ 5] << 16) ^
		((u32)key[ 6] <<  8) ^
		((u32)key[ 7]      );
	u32 K10 =
		((u32)key[ 8] << 24) ^
		((u32)key[ 9] << 16) ^
		((u32)key[10] <<  8) ^
		((u32)key[11]      );
	u32 K11 =
		((u32)key[12] << 24) ^
		((u32)key[13] << 16) ^
		((u32)key[14] <<  8) ^
		((u32)key[15]      );

	/*
	 * compute the round keys:
	 */
	for (r = 0; r <= R; r++) {
		/*
		 * K[r] = rho(c[r], K1) ^ K2;
		 */
		structpointer->roundKeyEnc[r][0] =
			U0[(K10 >> 24)       ] ^
			U1[(K10 >> 16) & 0xff] ^
			U2[(K10 >>  8) & 0xff] ^
			U3[(K10      ) & 0xff] ^
			V0[(K11 >> 24) & 0xff] ^
			V1[(K11 >> 16) & 0xff] ^
			V2[(K11 >>  8) & 0xff] ^
			V3[(K11      ) & 0xff] ^
			c[r][0] ^ K20;
		structpointer->roundKeyEnc[r][1] =
			U0[(K11 >> 24)       ] ^
			U1[(K11 >> 16) & 0xff] ^
			U2[(K11 >>  8) & 0xff] ^
			U3[(K11      ) & 0xff] ^
			V0[(K10 >> 24) & 0xff] ^
			V1[(K10 >> 16) & 0xff] ^
			V2[(K10 >>  8) & 0xff] ^
			V3[(K10      ) & 0xff] ^
			c[r][1] ^ K21;
		K20 = K10;
		K21 = K11;
		K10 = structpointer->roundKeyEnc[r][0];
		K11 = structpointer->roundKeyEnc[r][1];
	}
	/*
	 * compute the inverse key schedule:
	 * K'^0 = K^R, K'^R = K^0, K'^r = theta(K^{R-r})
	 */
	structpointer->roundKeyDec[0][0] = structpointer->roundKeyEnc[R][0];
	structpointer->roundKeyDec[0][1] = structpointer->roundKeyEnc[R][1];
	for (r = 1; r < R; r++) {
		K10 = structpointer->roundKeyEnc[R - r][0];
		K11 = structpointer->roundKeyEnc[R - r][1];
		structpointer->roundKeyDec[r][0] =
			U0[S[(K10 >> 24)       ] & 0xff] ^
			U1[S[(K10 >> 16) & 0xff] & 0xff] ^
			U2[S[(K10 >>  8) & 0xff] & 0xff] ^
			U3[S[(K10      ) & 0xff] & 0xff] ^
			V0[S[(K11 >> 24) & 0xff] & 0xff] ^
			V1[S[(K11 >> 16) & 0xff] & 0xff] ^
			V2[S[(K11 >>  8) & 0xff] & 0xff] ^
			V3[S[(K11      ) & 0xff] & 0xff];
		structpointer->roundKeyDec[r][1] =
			U0[S[(K11 >> 24)       ] & 0xff] ^
			U1[S[(K11 >> 16) & 0xff] & 0xff] ^
			U2[S[(K11 >>  8) & 0xff] & 0xff] ^
			U3[S[(K11      ) & 0xff] & 0xff] ^
			V0[S[(K10 >> 24) & 0xff] & 0xff] ^
			V1[S[(K10 >> 16) & 0xff] & 0xff] ^
			V2[S[(K10 >>  8) & 0xff] & 0xff] ^
			V3[S[(K10      ) & 0xff] & 0xff];
	}
	structpointer->roundKeyDec[R][0] = structpointer->roundKeyEnc[0][0];
	structpointer->roundKeyDec[R][1] = structpointer->roundKeyEnc[0][1];
}

/**
 * Either encrypt or decrypt a data block, according to the key schedule.
 * 
 * @param	block		the data block to be encrypted/decrypted.
 * @param	roundKey	the key schedule to be used.
 */
static void kcrypt(const u8 plaintext[/*8*/], u8 ciphertext[/*8*/],
				  const u32 roundKey[R + 1][2]) {
	int r;
	u32 s0, s1, t0, t1;

    /*
	 * map plaintext block to cipher state (mu)
	 * and add initial round key (sigma[K^0]):
	 */
	s0 =
		((u32)plaintext[0] << 24) ^
		((u32)plaintext[1] << 16) ^
		((u32)plaintext[2] <<  8) ^
		((u32)plaintext[3]      ) ^
		roundKey[0][0];
	s1 =
		((u32)plaintext[4] << 24) ^
		((u32)plaintext[5] << 16) ^
		((u32)plaintext[6] <<  8) ^
		((u32)plaintext[7]      ) ^
		roundKey[0][1];

    /*
	 * R - 1 full rounds:
	 */
    for (r = 1; r < R; r++) {
		t0 =
			U0[(s0 >> 24)       ] ^
			U1[(s0 >> 16) & 0xff] ^
			U2[(s0 >>  8) & 0xff] ^
			U3[(s0      ) & 0xff] ^
			V0[(s1 >> 24) & 0xff] ^
			V1[(s1 >> 16) & 0xff] ^
			V2[(s1 >>  8) & 0xff] ^
			V3[(s1      ) & 0xff] ^
			roundKey[r][0];
		t1 =
			U0[(s1 >> 24)       ] ^
			U1[(s1 >> 16) & 0xff] ^
			U2[(s1 >>  8) & 0xff] ^
			U3[(s1      ) & 0xff] ^
			V0[(s0 >> 24) & 0xff] ^
			V1[(s0 >> 16) & 0xff] ^
			V2[(s0 >>  8) & 0xff] ^
			V3[(s0      ) & 0xff] ^
			roundKey[r][1];
		s0 = t0;
		s1 = t1;
    }

    /*
	 * last round:
	 */
	s0 =
		(U0[(s0 >> 24)       ] & 0xff000000UL) ^
		(U1[(s0 >> 16) & 0xff] & 0x00ff0000UL) ^
		(U2[(s0 >>  8) & 0xff] & 0x0000ff00UL) ^
		(U3[(s0      ) & 0xff] & 0x000000ffUL) ^
		roundKey[R][0];
	s1 =
		(U0[(s1 >> 24)       ] & 0xff000000UL) ^
		(U1[(s1 >> 16) & 0xff] & 0x00ff0000UL) ^
		(U2[(s1 >>  8) & 0xff] & 0x0000ff00UL) ^
		(U3[(s1      ) & 0xff] & 0x000000ffUL) ^
		roundKey[R][1];

	/*
	 * map cipher state to ciphertext block (mu^{-1}):
	 */
	ciphertext[0] = (u8)(s0 >> 24);
	ciphertext[1] = (u8)(s0 >> 16);
	ciphertext[2] = (u8)(s0 >>  8);
	ciphertext[3] = (u8)(s0      );
	ciphertext[4] = (u8)(s1 >> 24);
	ciphertext[5] = (u8)(s1 >> 16);
	ciphertext[6] = (u8)(s1 >>  8);
	ciphertext[7] = (u8)(s1      );
}

/**
 * Encrypt a data block.
 * 
 * @param	structpointer	the expanded key.
 * @param	plaintext		the data block to be encrypted.
 * @param	ciphertext		the encrypted data block.
 */
void NESSIEencrypt(const struct NESSIEstruct * const structpointer,
				   const unsigned char * const plaintext,
				         unsigned char * const ciphertext)
{
	kcrypt(plaintext, ciphertext, structpointer->roundKeyEnc);
}

/**
 * Decrypt a data block.
 * 
 * @param	structpointer	the expanded key.
 * @param	ciphertext		the data block to be decrypted.
 * @param	plaintext		the decrypted data block.
 */
void NESSIEdecrypt(const struct NESSIEstruct * const structpointer,
				   const unsigned char * const ciphertext,
				         unsigned char * const plaintext)
{
	kcrypt(ciphertext, plaintext, structpointer->roundKeyDec);
}

void print_data(char *str, u8 *val, int len)
{
  int i;

  static char *hex="0123456789abcdef";

  printf("%s=", str);
  for(i=0; i<len; i++)
    {
      putchar(hex[(val[i]>>4)&0xf]);
      putchar(hex[(val[i]   )&0xf]);
    }
  putchar('\n');
}

int compare_blocks(u8 *m1, u8 *m2, int len_bits)
{
  int i;
  int lenb=(len_bits+7)>>3;
  int mask0 = (1<<(((len_bits-1)&7)+1))-1;

  if((m1[0]&mask0) != (m2[0]&mask0))
    return 1;

  for(i=1; i<lenb; i++)
    if(m1[i] != m2[i])
        return 1;

  return 0;
}

int main(void)
{
  struct NESSIEstruct subkeys;
  u8 key[KEYSIZEB];
  u8 plain[BLOCKSIZEB];
  u8 cipher[BLOCKSIZEB];
  u8 decrypted[BLOCKSIZEB];

  int v;

  printf("Test vectors -- set 1\n");
  printf("=====================\n\n");

  /* If key size is not a multiple of 8, this tests too much (intentionally) */
  for(v=0; v<(KEYSIZEB*8); v++)
    {
      memset(plain, 0, BLOCKSIZEB);
      memset(key, 0, KEYSIZEB);
      key[v>>3] = 1<<(7-(v&7));

      NESSIEkeysetup(key, &subkeys);
      NESSIEencrypt(&subkeys, plain, cipher);
      NESSIEdecrypt(&subkeys, cipher, decrypted);

      printf("Set 1, vector#%3d:\n", v);
      print_data("key", key, KEYSIZEB);
      print_data("plain", plain, BLOCKSIZEB);
      print_data("cipher", cipher, BLOCKSIZEB);
      print_data("decrypted", decrypted, BLOCKSIZEB);

      if(compare_blocks(plain, decrypted, BLOCKSIZE) != 0)
        printf("** Decryption error: **\n"
               "   Decrypted ciphertext is different than the plaintext!\n");

      printf("\n");
    }

  printf("Test vectors -- set 2\n");
  printf("=====================\n\n");

  /* If block size is not a multiple of 8, this tests too much (intentionally) */
  for(v=0; v<(BLOCKSIZEB*8); v++)
    {
      memset(plain, 0, BLOCKSIZEB);
      memset(key, 0, KEYSIZEB);
      plain[v>>3] = 1<<(7-(v&7));

      NESSIEkeysetup(key, &subkeys);
      NESSIEencrypt(&subkeys, plain, cipher);
      NESSIEdecrypt(&subkeys, cipher, decrypted);

      printf("Set 2, vector#%3d:\n", v);
      print_data("key", key, KEYSIZEB);
      print_data("plain", plain, BLOCKSIZEB);
      print_data("cipher", cipher, BLOCKSIZEB);
      print_data("decrypted", decrypted, BLOCKSIZEB);

      if(compare_blocks(plain, decrypted, BLOCKSIZE) != 0)
        printf("** Decryption error: **\n"
               "   Decrypted ciphertext is different than the plaintext!\n");

      printf("\n");
    }

  printf("Test vectors -- set 3\n");
  printf("=====================\n\n");

  for(v=0; v<256; v++)
    {
      memset(plain, v, BLOCKSIZEB);
      memset(key, v, KEYSIZEB);

      NESSIEkeysetup(key, &subkeys);
      NESSIEencrypt(&subkeys, plain, cipher);
      NESSIEdecrypt(&subkeys, cipher, decrypted);

      printf("Set 3, vector#%3d:\n", v);
      print_data("key", key, KEYSIZEB);
      print_data("plain", plain, BLOCKSIZEB);
      print_data("cipher", cipher, BLOCKSIZEB);
      print_data("decrypted", decrypted, BLOCKSIZEB);

      if(compare_blocks(plain, decrypted, BLOCKSIZE) != 0)
        printf("** Decryption error: **\n"
               "   Decrypted ciphertext is different than the plaintext!\n");

      printf("\n");
    }

  return 0;
}

