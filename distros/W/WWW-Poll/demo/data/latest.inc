
			<FORM ACTION="/~mgammon/poll/poll.pl" METHOD=post>
			<INPUT TYPE=hidden NAME=action VALUE=vote>
			<TABLE CELLPADDING=3 CELLSPACING=0 BORDER=0>
			<TD BGCOLOR=#333333>
			
			<TABLE CELLPADDING=1 CELLSPACING=0 BORDER=0>
			<TR><TD COLSPAN=2 VALIGN=top BGCOLOR=#99CCFF><strong>&nbsp;<FONT FACE="arial,helvetica" SIZE=1>Can Lou use this poll?&nbsp;</strong></TD></TR>
			<TR><TD COLSPAN=2 VALIGN=top BGCOLOR=#333333><SPACER TYPE=block WIDTH=100 HEIGHT=1></TD></TR>
			<TR><TD COLSPAN=2 VALIGN=top BGCOLOR=#cccccc><SPACER TYPE=block WIDTH=100 HEIGHT=1></TD></TR>
			<TR>
				<TD VALIGN=top BGCOLOR=#cccccc><INPUT TYPE=radio NAME=vote VALUE=1></TD>
				<TD BGCOLOR=#cccccc><FONT FACE="arial,helvetica" SIZE=1>Yes.</TD>
			</TR>
			<TR>
				<TD VALIGN=top BGCOLOR=#cccccc><INPUT TYPE=radio NAME=vote VALUE=2></TD>
				<TD BGCOLOR=#cccccc><FONT FACE="arial,helvetica" SIZE=1>No.</TD>
			</TR>
			<TR>
				<TD VALIGN=top BGCOLOR=#cccccc><INPUT TYPE=radio NAME=vote VALUE=3></TD>
				<TD BGCOLOR=#cccccc><FONT FACE="arial,helvetica" SIZE=1>Depends.</TD>
			</TR>
			<TR><TD COLSPAN=2 VALIGN=top BGCOLOR=#cccccc><SPACER TYPE=block WIDTH=100 HEIGHT=1></TD></TR>
			<TR>
				<TD VALIGN=top ALIGN=right BGCOLOR=#ccccccc COLSPAN=2>
					<FONT FACE="arial,helvetica" SIZE=1>&nbsp;<A HREF=/~mgammon/poll/poll_admin.pl?action=view>View Results</A>&nbsp;&nbsp;&nbsp;&nbsp;
					<INPUT TYPE=submit VALUE=" vote "></FONT> </TD>
			</TR>
			<TR><TD COLSPAN=2 VALIGN=top BGCOLOR=#cccccc><SPACER TYPE=block WIDTH=100 HEIGHT=1></TD></TR>
			</TABLE>
			
			</TD></TABLE>
			</FORM>